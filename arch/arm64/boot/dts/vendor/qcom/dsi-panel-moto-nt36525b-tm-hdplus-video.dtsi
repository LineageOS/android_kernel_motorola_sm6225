/* Copyright (c) 2015, 2018, The Linux Foundation. All rights reserved.
 *
 * This program is free software; you can redistribute it and/or modify
 * it under the terms of the GNU General Public License version 2 and
 * only version 2 as published by the Free Software Foundation.
 *
 * This program is distributed in the hope that it will be useful,
 * but WITHOUT ANY WARRANTY; without even the implied warranty of
 * MERCHANTABILITY or FITNESS FOR A PARTICULAR PURPOSE.  See the
 * GNU General Public License for more details.
 */

/*---------------------------------------------------------------------------
 * This file is autogenerated file using gcdb parser. Please do not edit it.
 * Update input XML file to add a new entry or update variable in this file
 * VERSION = "1.0"
 *---------------------------------------------------------------------------
 */

&mdss_mdp {
	dsi_tm_nt36525b_video:qcom,mdss_dsi_nt36525b_tm_video {
		qcom,mdss-dsi-panel-name ="mipi_mot_vid_tm_720p_678";
		qcom,mdss-dsi-panel-type = "dsi_video_mode";
                qcom,mdss-dsi-panel-supplier = "tianma";

		qcom,dsi-ctrl-num = <0>;
		qcom,dsi-phy-num = <0>;

		qcom,mdss-dsi-virtual-channel-id = <0>;
		qcom,mdss-dsi-stream = <0>;
		qcom,mdss-dsi-h-left-border = <0>;
		qcom,mdss-dsi-h-right-border = <0>;
		qcom,mdss-dsi-v-top-border = <0>;
		qcom,mdss-dsi-v-bottom-border = <0>;
		qcom,mdss-dsi-bpp = <24>;
		qcom,mdss-dsi-color-order = "rgb_swap_rgb";
		qcom,mdss-dsi-underflow-color = <0xff>;
		qcom,mdss-dsi-border-color = <0>;
		qcom,mdss-dsi-h-sync-pulse = <0>;
		qcom,mdss-dsi-traffic-mode = "non_burst_sync_event";
		qcom,mdss-dsi-lane-map = "lane_map_0123";
		qcom,mdss-dsi-bllp-eof-power-mode;
		qcom,mdss-dsi-bllp-power-mode;
		qcom,mdss-dsi-tx-eot-append;
		qcom,mdss-dsi-lane-0-state;
		qcom,mdss-dsi-lane-1-state;
		qcom,mdss-dsi-lane-2-state;
		qcom,mdss-dsi-lane-3-state;
		qcom,mdss-dsi-dma-trigger = "trigger_sw";
		qcom,mdss-dsi-mdp-trigger = "none";
		qcom,mdss-dsi-lp11-init;
		qcom,platform-reset-gpio-always-on;
		qcom,mdss-panel-on-rst-pull-down;
		qcom,mdss-dsi-reset-sequence = <1 10>, <0 10>, <1 10>;
		qcom,mdss-pan-physical-width-dimension = <69>;
		qcom,mdss-pan-physical-height-dimension = <158>;

		qcom,mdss-dsi-bl-pmic-control-type = "bl_ctrl_wled";
		qcom,mdss-dsi-bl-min-level = <1>;
		qcom,mdss-dsi-bl-max-level = <2047>;
		qcom,mdss-dsi-bl-default-level = <127>;

		qcom,mdss-dsi-cabc-ui-command = [15 01 00 00 00 00 02 55 01];
		qcom,mdss-dsi-cabc-ui-command-state = "dsi_hs_mode";
		qcom,mdss-dsi-cabc-mv-command = [15 01 00 00 00 00 02 55 03];
		qcom,mdss-dsi-cabc-mv-command-state = "dsi_hs_mode";
		qcom,mdss-dsi-cabc-dis-command = [15 01 00 00 00 00 02 55 00];
		qcom,mdss-dsi-cabc-dis-command-state = "dsi_hs_mode";
		qcom,mdss-dsi-hbm-on-command = [39 01 00 00 00 00 03 51 0F FF];
		qcom,mdss-dsi-hbm-on-command-state = "dsi_hs_mode";
		qcom,mdss-dsi-hbm-off-command = [39 01 00 00 00 00 03 51 0C CC];
		qcom,mdss-dsi-hbm-off-command-state = "dsi_hs_mode";

		qcom,mdss-dsi-display-timings {
			timing@0{
				qcom,mdss-dsi-panel-width = <720>;
				qcom,mdss-dsi-panel-height = <1640>;
				qcom,mdss-dsi-h-front-porch = <136>;
				qcom,mdss-dsi-h-back-porch = <130>;
				qcom,mdss-dsi-h-pulse-width = <10>;
				qcom,mdss-dsi-h-sync-skew = <0>;
				qcom,mdss-dsi-v-back-porch = <14>;
				qcom,mdss-dsi-v-front-porch = <16>;
				qcom,mdss-dsi-v-pulse-width = <2>;
				qcom,mdss-dsi-panel-framerate = <60>;
				qcom,mdss-dsi-on-command = [
					15 01 00 00 00 00 02 FF 23
					15 01 00 00 00 00 02 FB 01
					15 01 00 00 00 00 02 10 40
					15 01 00 00 00 00 02 11 00
					15 01 00 00 00 00 02 12 B8
					15 01 00 00 00 00 02 15 E3
					15 01 00 00 00 00 02 16 0B
					15 01 00 00 00 00 02 29 10
					15 01 00 00 00 00 02 2A 20
					15 01 00 00 00 00 02 2B 30
					15 01 00 00 00 00 02 30 FF
					15 01 00 00 00 00 02 31 FF
					15 01 00 00 00 00 02 32 FF
					15 01 00 00 00 00 02 33 FC
					15 01 00 00 00 00 02 34 F9
					15 01 00 00 00 00 02 35 F4
					15 01 00 00 00 00 02 36 EE
					15 01 00 00 00 00 02 37 EB
					15 01 00 00 00 00 02 38 E8
					15 01 00 00 00 00 02 39 E6
					15 01 00 00 00 00 02 3A E4
					15 01 00 00 00 00 02 3B E2
					15 01 00 00 00 00 02 3D E0
					15 01 00 00 00 00 02 3F DF
					15 01 00 00 00 00 02 40 DD
					15 01 00 00 00 00 02 41 DC
					15 01 00 00 00 00 02 58 FF
					15 01 00 00 00 00 02 59 FC
					15 01 00 00 00 00 02 5A F7
					15 01 00 00 00 00 02 5B EF
					15 01 00 00 00 00 02 5C E6
					15 01 00 00 00 00 02 5D DE
					15 01 00 00 00 00 02 5E D6
					15 01 00 00 00 00 02 5F D0
					15 01 00 00 00 00 02 60 C8
					15 01 00 00 00 00 02 61 C0
					15 01 00 00 00 00 02 62 BA
					15 01 00 00 00 00 02 63 B6
					15 01 00 00 00 00 02 64 B2
					15 01 00 00 00 00 02 65 AE
					15 01 00 00 00 00 02 66 AC
					15 01 00 00 00 00 02 67 AA
					15 01 00 00 00 00 02 FF 10
					15 01 00 00 00 00 02 FB 01
					15 01 00 00 00 00 02 BA 03
					15 01 00 00 00 00 02 35 00
					39 01 00 00 00 00 03 51 0C CC
					15 01 00 00 00 00 02 53 2C
					15 01 00 00 00 00 02 55 01
					05 01 00 00 78 00 01 11
					05 01 00 00 14 00 01 29
					];
				qcom,mdss-dsi-off-command = [
					05 01 00 00 14 00 01 28
					05 01 00 00 78 00 01 10
					];
				qcom,mdss-dsi-on-command-state = "dsi_lp_mode";
				qcom,mdss-dsi-off-command-state = "dsi_lp_mode";
			};
		};
	};
};

