/* Copyright (c) 2020, The Linux Foundation. All rights reserved.
 *
 * This program is free software; you can redistribute it and/or modify
 * it under the terms of the GNU General Public License version 2 and
 * only version 2 as published by the Free Software Foundation.
 *
 * This program is distributed in the hope that it will be useful,
 * but WITHOUT ANY WARRANTY; without even the implied warranty of
 * MERCHANTABILITY or FITNESS FOR A PARTICULAR PURPOSE.  See the
 * GNU General Public License for more details.
 */

/*---------------------------------------------------------------------------
 * This file is autogenerated file using gcdb parser. Please do not edit it.
 * Update input XML file to add a new entry or update variable in this file
 * VERSION = "1.0"
 *---------------------------------------------------------------------------
 */

&mdss_mdp {
	dsi_djn_nt36525b_652_vid_v0:qcom,mdss_dsi_djn_nt36525b_652_vid_v0 {
		qcom,mdss-dsi-panel-name ="mipi_mot_vid_djn_nt36525b_652_v0";
		qcom,mdss-dsi-panel-type = "dsi_video_mode";
		qcom,mdss-dsi-panel-supplier = "djn";

		qcom,dsi-ctrl-num = <0>;
		qcom,dsi-phy-num = <0>;

		qcom,mdss-dsi-virtual-channel-id = <0>;
		qcom,mdss-dsi-stream = <0>;
		qcom,mdss-dsi-h-left-border = <0>;
		qcom,mdss-dsi-h-right-border = <0>;
		qcom,mdss-dsi-v-top-border = <0>;
		qcom,mdss-dsi-v-bottom-border = <0>;
		qcom,mdss-dsi-bpp = <24>;
		qcom,mdss-dsi-color-order = "rgb_swap_rgb";
		qcom,mdss-dsi-underflow-color = <0xff>;
		qcom,mdss-dsi-border-color = <0>;
		qcom,mdss-dsi-h-sync-pulse = <1>;
		qcom,mdss-dsi-traffic-mode = "non_burst_sync_event";
		qcom,mdss-dsi-lane-map = "lane_map_0123";
		qcom,mdss-dsi-bllp-eof-power-mode;
		qcom,mdss-dsi-bllp-power-mode;
		qcom,mdss-dsi-tx-eot-append;
		qcom,mdss-dsi-lane-0-state;
		qcom,mdss-dsi-lane-1-state;
		qcom,mdss-dsi-lane-2-state;
		qcom,mdss-dsi-lane-3-state;
		qcom,mdss-dsi-dma-trigger = "trigger_sw";
		qcom,mdss-dsi-mdp-trigger = "none";
		qcom,mdss-dsi-lp11-init;
		qcom,mdss-dsi-reset-sequence = <1 10>, <0 10>, <1 10>;
		qcom,mdss-pan-physical-width-dimension = <68>;
		qcom,mdss-pan-physical-height-dimension = <151>;

		qcom,mdss-dsi-bl-pmic-control-type = "bl_ctrl_wled";
		qcom,mdss-dsi-bl-min-level = <1>;
		qcom,mdss-dsi-bl-max-level = <4095>;
		qcom,mdss-dsi-bl-default-level = <127>;

		qcom,mdss-dsi-cabc-ui-command = [15 01 00 00 00 00 02 55 01];
		qcom,mdss-dsi-cabc-ui-command-state = "dsi_hs_mode";
		qcom,mdss-dsi-cabc-mv-command = [15 01 00 00 00 00 02 55 03];
		qcom,mdss-dsi-cabc-mv-command-state = "dsi_hs_mode";
		qcom,mdss-dsi-cabc-dis-command = [15 01 00 00 00 00 02 55 00];
		qcom,mdss-dsi-cabc-dis-command-state = "dsi_hs_mode";
		qcom,mdss-dsi-hbm-on-command = [39 01 00 00 00 00 03 51 07 FF];
		qcom,mdss-dsi-hbm-on-command-state = "dsi_hs_mode";
		qcom,mdss-dsi-hbm-off-command = [39 01 00 00 00 00 03 51 06 CC];
		qcom,mdss-dsi-hbm-off-command-state = "dsi_hs_mode";

		qcom,mdss-dsi-display-timings {
			timing@0{
				qcom,mdss-dsi-panel-width = <720>;
				qcom,mdss-dsi-panel-height = <1600>;
				qcom,mdss-dsi-h-front-porch = <64>;
				qcom,mdss-dsi-h-back-porch = <60>;
				qcom,mdss-dsi-h-pulse-width = <4>;
				qcom,mdss-dsi-h-sync-skew = <0>;
				qcom,mdss-dsi-v-back-porch = <244>;
				qcom,mdss-dsi-v-front-porch = <8>;
				qcom,mdss-dsi-v-pulse-width = <2>;
				qcom,mdss-dsi-panel-framerate = <60>;
				qcom,mdss-dsi-on-command = [
					15 01 00 00 00 00 02 FF 20
					15 01 00 00 00 00 02 FB 01
					15 01 00 00 00 00 02 00 01
					15 01 00 00 00 00 02 01 55
					15 01 00 00 00 00 02 03 55
					15 01 00 00 00 00 02 05 69
					15 01 00 00 00 00 02 07 2D
					15 01 00 00 00 00 02 08 99
					15 01 00 00 00 00 02 0E 4B
					15 01 00 00 00 00 02 0F 37
					15 01 00 00 00 00 02 69 A9

					15 01 00 00 00 00 02 FF 24
					15 01 00 00 00 00 02 FB 01
					15 01 00 00 00 00 02 03 00
					15 01 00 00 00 00 02 04 00
					15 01 00 00 00 00 02 05 00
					15 01 00 00 00 00 02 06 00
					15 01 00 00 00 00 02 07 20
					15 01 00 00 00 00 02 08 21
					15 01 00 00 00 00 02 09 10
					15 01 00 00 00 00 02 0A 0F
					15 01 00 00 00 00 02 0B 0E
					15 01 00 00 00 00 02 0C 0D
					15 01 00 00 00 00 02 0D 0C
					15 01 00 00 00 00 02 0E 04
					15 01 00 00 00 00 02 12 00
					15 01 00 00 00 00 02 13 00
					15 01 00 00 00 00 02 14 01
					15 01 00 00 00 00 02 15 01
					15 01 00 00 00 00 02 19 00
					15 01 00 00 00 00 02 1A 00
					15 01 00 00 00 00 02 1B 00
					15 01 00 00 00 00 02 1C 00
					15 01 00 00 00 00 02 1D 20
					15 01 00 00 00 00 02 1E 21
					15 01 00 00 00 00 02 1F 10
					15 01 00 00 00 00 02 20 0F
					15 01 00 00 00 00 02 21 0E
					15 01 00 00 00 00 02 22 0D
					15 01 00 00 00 00 02 23 0C
					15 01 00 00 00 00 02 24 04
					15 01 00 00 00 00 02 28 00
					15 01 00 00 00 00 02 29 00
					15 01 00 00 00 00 02 2A 01
					15 01 00 00 00 00 02 2B 01
					15 01 00 00 00 00 02 2F 00
					15 01 00 00 00 00 02 33 00
					15 01 00 00 00 00 02 37 11
					15 01 00 00 00 00 02 39 00
					15 01 00 00 00 00 02 3A 05
					15 01 00 00 00 00 02 3B A0
					15 01 00 00 00 00 02 3D 41
					15 01 00 00 00 00 02 4D 12
					15 01 00 00 00 00 02 4E 34
					15 01 00 00 00 00 02 4F 50
					15 01 00 00 00 00 02 51 54
					15 01 00 00 00 00 02 52 32
					15 01 00 00 00 00 02 53 10
					15 01 00 00 00 00 02 55 40
					15 01 00 00 00 00 02 56 15
					15 01 00 00 00 00 02 58 10
					15 01 00 00 00 00 02 5A 05
					15 01 00 00 00 00 02 5B A0
					15 01 00 00 00 00 02 5C 00
					15 01 00 00 00 00 02 5D 00
					15 01 00 00 00 00 02 5E 05
					15 01 00 00 00 00 02 5F 00
					15 01 00 00 00 00 02 86 04
					15 01 00 00 00 00 02 92 AE
					15 01 00 00 00 00 02 93 08
					15 01 00 00 00 00 02 94 06
					15 01 00 00 00 00 02 AB 00
					15 01 00 00 00 00 02 AC 00
					15 01 00 00 00 00 02 AD 00
					15 01 00 00 00 00 02 AF 04
					15 01 00 00 00 00 02 B0 05
					15 01 00 00 00 00 02 B1 A9
					15 01 00 00 00 00 02 60 80
					15 01 00 00 00 00 02 61 90
					15 01 00 00 00 00 02 64 11

					15 01 00 00 00 00 02 FF 25
					15 01 00 00 00 00 02 FB 01
					15 01 00 00 00 00 02 0A 82
					15 01 00 00 00 00 02 0B 29
					15 01 00 00 00 00 02 0C 01
					15 01 00 00 00 00 02 17 82
					15 01 00 00 00 00 02 18 06
					15 01 00 00 00 00 02 19 0F
					15 01 00 00 00 00 02 58 00
					15 01 00 00 00 00 02 59 00
					15 01 00 00 00 00 02 5A 50
					15 01 00 00 00 00 02 5B 80
					15 01 00 00 00 00 02 5C 00
					15 01 00 00 00 00 02 5D 05
					15 01 00 00 00 00 02 5E A0
					15 01 00 00 00 00 02 5F 05
					15 01 00 00 00 00 02 60 A0
					15 01 00 00 00 00 02 61 05
					15 01 00 00 00 00 02 62 A0
					15 01 00 00 00 00 02 65 05
					15 01 00 00 00 00 02 66 A9
					15 01 00 00 00 00 02 CA 04
					15 01 00 00 00 00 02 CC 34
					15 01 00 00 00 00 02 D6 44
					15 01 00 00 00 00 02 D7 30

					15 01 00 00 00 00 02 FF 26
					15 01 00 00 00 00 02 FB 01
					15 01 00 00 00 00 02 00 A0

					15 01 00 00 00 00 02 FF 27
					15 01 00 00 00 00 02 FB 01
					15 01 00 00 00 00 02 13 00
					15 01 00 00 00 00 02 15 B4
					15 01 00 00 00 00 02 1F 55
					15 01 00 00 00 00 02 26 0F
					15 01 00 00 00 00 02 C0 18
					15 01 00 00 00 00 02 C1 F0
					15 01 00 00 00 00 02 C2 00
					15 01 00 00 00 00 02 C3 00
					15 01 00 00 00 00 02 C4 F0
					15 01 00 00 00 00 02 C5 00
					15 01 00 00 00 00 02 C6 00
					15 01 00 00 00 00 02 C7 03
					15 01 00 00 00 00 02 FF 23
					15 01 00 00 00 00 02 FB 01
					15 01 00 00 00 00 02 04 05
					15 01 00 00 00 00 02 05 2D
					15 01 00 00 00 00 02 06 01
					15 01 00 00 00 00 02 FF 10
					15 01 00 00 00 00 02 FB 01
					39 01 00 00 00 00 03 68 03 01
					39 01 00 00 00 00 03 51 00 0a
					15 01 00 00 00 00 02 53 2C
					15 01 00 00 00 00 02 55 01

					05 01 00 00 28 00 01 29
					05 01 00 00 78 00 01 11
					];
				qcom,mdss-dsi-off-command = [
					05 01 00 00 32 00 01 28
					05 01 00 00 96 00 01 10];
				qcom,mdss-dsi-on-command-state = "dsi_lp_mode";
				qcom,mdss-dsi-off-command-state = "dsi_hs_mode";
			};
		};
	};
};

