/*
 * Copyright (C) 2021 Motorola Inc.
 *
 * This program is free software; you can redistribute it and/or modify
 * it under the terms of the GNU General Public License version 2 as
 * published by the Free Software Foundation.
 *
 * This program is distributed in the hope that it will be useful,
 * but WITHOUT ANY WARRANTY; without even the implied warranty of
 * MERCHANTABILITY or FITNESS FOR A PARTICULAR PURPOSE.
 * See http://www.gnu.org/licenses/gpl-2.0.html for more details.
 */
jd50-atl-5000mah {
	serialnum = "SB18C77591";
	fcc_design = <4850>;
	config_profile_info = [5A 00 00 00 00 00 00 00
				 A0 B2 BF CB C3 C2 96 59
				 2F FF FF DB A6 8D 74 60
				 55 52 4D 8D FD DC 02 CF
				 CF D2 D1 D1 D0 CD C8 CD
				 C1 C0 C5 AD 95 8A 81 74
				 62 62 73 8F A7 87 5F 62
				 20 00 57 10 02 B0 76 00
				 00 00 64 28 D3 7C 00 00
				 00 00 00 00 00 00 00 44 ];
};
