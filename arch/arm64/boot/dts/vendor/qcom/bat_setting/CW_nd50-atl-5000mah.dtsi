/*
 * Copyright (C) 2021 Motorola Inc.
 *
 * This program is free software; you can redistribute it and/or modify
 * it under the terms of the GNU General Public License version 2 as
 * published by the Free Software Foundation.
 *
 * This program is distributed in the hope that it will be useful,
 * but WITHOUT ANY WARRANTY; without even the implied warranty of
 * MERCHANTABILITY or FITNESS FOR A PARTICULAR PURPOSE.
 * See http://www.gnu.org/licenses/gpl-2.0.html for more details.
 */
nd50-atl-5000mah {
	serialnum = "SB18D24973";
	fcc_design = <4700>;
        ui_full = <99>;
	config_profile_info = [5A 00 00 00 00 00 00 00
                        B3 B7 BC CA C0 B7 A7 6A
			43 FF FF C0 92 81 67 58
			50 4D 49 82 DB DE AA E0
			D6 CF D4 D5 D5 D1 CE CA
			C5 C3 CE C1 9A 8F 86 7B
			6D 6A 7D 8F A6 91 5B 79
			20 00 AB 10 00 A0 66 00
			00 00 64 28 C3 61 00 00
			00 00 00 0000 00 00 4C];
};

