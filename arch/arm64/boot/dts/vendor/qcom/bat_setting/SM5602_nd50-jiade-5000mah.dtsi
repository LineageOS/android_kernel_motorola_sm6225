/*
 * Copyright (C) 2021 Motorola Inc.
 *
 * This program is free software; you can redistribute it and/or modify
 * it under the terms of the GNU General Public License version 2 as
 * published by the Free Software Foundation.
 *
 * This program is distributed in the hope that it will be useful,
 * but WITHOUT ANY WARRANTY; without even the implied warranty of
 * MERCHANTABILITY or FITNESS FOR A PARTICULAR PURPOSE.
 * See http://www.gnu.org/licenses/gpl-2.0.html for more details.
 */
sm5602-nd50-jiade-5000mah {
        serialnum = "SB18D25053";
        battery,param_version = <4>;
        battery,max_voltage_uv = <4450000>;
        battery,battery_type = <4450 0x0 0x2728>;
        battery,battery_table0 = <0x1400 0x1B15 0x1C4C 0x1D2F 0x1D78 0x1D83 0x1D8C 0x1D92 0x1DAF
        	       0x1DF8 0x1E3C 0x1E73 0x1EAD 0x1F01 0x1F54 0x1FA0 0x2002 0x20CC 0x217A 0x21F5
		       0x224C 0x22EC 0x2331 0x24CC>;
        battery,battery_table1 = <0x0 0x67 0x1EF 0x3FA 0x583 0x688 0x893 0xB21 0xD2C 0x13D0 0x1B79
				0x2322 0x2ACC 0x3275 0x3790 0x3A1E 0x3F39 0x4970 0x511A 0x5635
				0x59C8 0x60EF 0x6400 0x64E6>;
        battery,battery_table2 = <0x2535 0x1C1F 0x1819 0x1819 0x1415 0x1213 0x1111 0x1010 0x0F0F>;
        battery,alpha = <0x00CC>;
        battery,beta = <0x0025>;
        battery,rs = <0x005F>;
        battery,rs_value = <0x0050 0x010A 0x3800 0x0048>;
        battery,vit_period = <0x315A>;
        battery,volt_cal = <0x8000>;
        battery,mix_value = <0x0003>;
        battery,curr_offset = <0x000>;
        battery,curr_slope = <0x8080>;
        battery,topoff_soc = <7 500>;
        battery,temp_std = <25>;
        battery,temp_offset = <0 11 1 0 8 (-1)>;
        battery,temp_cal = <0 6 1 11 (-1) 0 6 1 9 1>;
        battery,ext_temp_cal = <0 2 1 2 1 1 2 3 2 3>;
        battery,tem_poff = <3400 100>;
     battery,thermal_table = <0x435B 0x3E57 0x3963 0x3486 0x2FC5 0x2B1B 0x2688 0x2200 0x1DA3 0x1932
			      0x1534 0x1148 0x0D46 0x096E 0x05A0 0x01F4 0xF62D 0xF2BC 0xEF68 0xEC08
			      0xE8E0 0xE5D2 0xE2DC 0xDFFC 0xDD33 0xDA83 0xD7E5 0xD55E 0xD2EF 0xD092
			      0xCE4A 0xCC12 0xC9EF 0xC7E3 0xC5E4 0xC3F8 0xC21D 0xC051 0xBE97 0xBCE9
			      0xBB4D 0xB9C2 0xB840 0xB6CF 0xB569 0xB40F 0xB2C2 0xB17F 0xB049 0xAF1E
			      0xADFD 0xACE4 0xABD7 0xAAD5 0xA9DD 0xA8EB 0xA805 0xA71E 0xA648 0xA577
			      0xA4B0 0xA3ED 0xA32F 0xA27D 0xA1CE 0xA124 0xA082 0x9FE7 0x9F50 0x9EBC
			      0x9E2B 0x9DA3 0x9D20 0x9CA1 0x9C27 0x9BAF 0x9B3B 0x9ACC 0x9A62 0x99FA
			      0x9996 0x9938 0x98DE 0x9885 0x982E 0x97DA 0x978A 0x973D 0x96F2 0x96AA
			      0x9665 0x9621 0x95DF 0x959F 0x9561 0x9525 0x94EB 0x94B3 0x947C 0x9447
			      0x9414>;    //NTC value(DEC) table -20~80
};
