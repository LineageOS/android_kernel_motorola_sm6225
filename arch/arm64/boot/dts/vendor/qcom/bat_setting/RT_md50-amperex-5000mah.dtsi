/*
 * Copyright (C) 2021 MediaTek Inc.
 *
 * This program is free software; you can redistribute it and/or modify
 * it under the terms of the GNU General Public License version 2 as
 * published by the Free Software Foundation.
 *
 * This program is distributed in the hope that it will be useful,
 * but WITHOUT ANY WARRANTY; without even the implied warranty of
 * MERCHANTABILITY or FITNESS FOR A PARTICULAR PURPOSE.
 * See http://www.gnu.org/licenses/gpl-2.0.html for more details.
 */
md50-amperex-5000mah {
        serialnum = "SB18D33989";
	/* add for aging cv */
	rt,fcc = <4895 4895 4895 4895 4895>;
	rt,fg_fc_vth = <0x9e 0x9e 0x9e 0x9e 0x9e>;
	rt,fg_extreg_table = [80 80 33 6E B7 E4 58 02 CF 98 61 3A 88 81 00 00
				80 34 00 00 FB 3E 00 20 FF 08 1D 32 12 05 5A 5A
				00 82 00 02 00 02 00 40 00 40 1F 13 1F 13 04 24
				64 00 5F 0B 64 00 5F 0B FF 00 00 14 00 00 14 B7
				15 0E 48 44 9E 4C 05 41 19 05 8D 12 23 32 1F 00
				13 88 24 82 77 AD 04 73 12 A3 52 68 57 64 25 0F
				20 16 03 04 04 04 00 00 00 00 02 02 02 00 00 FD
				FC FA FA FA F9 F9 EE E5 9B 9B 9B EB EB C0 AD 00
				76 02 E0 48 14 09 00 00 00 00 00 00 00 00 37 73
				2D 19 05 FB 00 00 B9 36 96 33 0F 07 00 00 0B A9
				32 32 88 88 32 32 88 88 32 32 88 88 32 32 88 88
				32 32 88 88 32 32 88 88 32 32 88 88 32 32 88 88
				32 32 88 88 32 32 88 88 32 32 88 88 32 32 88 88
				32 32 88 88 32 32 88 88 32 32 88 88 32 32 88 88 ];
	rt,fg_ocv_table0 = <0x0013 0x49C0 0x5000 0x57C1 0x5B7E 0x5C32 0x5CE3 0x5E1B
			   0x5F9C 0x6089 0x6162 0x6277 0x6356 0x65CA 0x6820 0x6985
			   0x6AB7 0x6BFF 0x6D46 0x706D 0x1900 0x07C1 0x02E0 0x00BE
			   0x002D 0x0041 0x002F 0x0038 0x0050 0x0096 0x007F 0x007C
			   0x0092 0x0092 0x0092 0x0092 0x005F 0x0143 0x0013 0xFF80
			   0x0000 0x0200 0x049A 0x0680 0x0E4D 0x17E6 0x281A 0x309A
			   0x3600 0x39B3 0x3D33 0x474D 0x4F80 0x5466 0x589A 0x5D1A
			   0x6400 0x6900 0x000A 0x0021 0x0059 0x0159 0x05A7 0x03EE
			   0x0564 0x0498 0x0330 0x01B5 0x0203 0x020F 0x01C2 0x01C2
			   0x01C2 0x01C2 0x02B3 0x00CB 0x6684 0x0000 0x0000 0x0000 >;
	rt,fg_ocv_table1 = <0x0013 0x49C0 0x5000 0x57C1 0x5B7E 0x5C32 0x5CE3 0x5E1B
			   0x5F9C 0x6089 0x6162 0x6277 0x6356 0x65CA 0x6820 0x6985
			   0x6AB7 0x6BFF 0x6D46 0x706D 0x1900 0x07C1 0x02E0 0x00BE
			   0x002D 0x0041 0x002F 0x0038 0x0050 0x0096 0x007F 0x007C
			   0x0092 0x0092 0x0092 0x0092 0x005F 0x0143 0x0013 0xFF80
			   0x0000 0x0200 0x049A 0x0680 0x0E4D 0x17E6 0x281A 0x309A
			   0x3600 0x39B3 0x3D33 0x474D 0x4F80 0x5466 0x589A 0x5D1A
			   0x6400 0x6900 0x000A 0x0021 0x0059 0x0159 0x05A7 0x03EE
			   0x0564 0x0498 0x0330 0x01B5 0x0203 0x020F 0x01C2 0x01C2
			   0x01C2 0x01C2 0x02B3 0x00CB 0x6684 0x0000 0x0000 0x0000 >;
	rt,fg_ocv_table2 = <0x0013 0x49C0 0x5000 0x57C1 0x5B7E 0x5C32 0x5CE3 0x5E1B
			   0x5F9C 0x6089 0x6162 0x6277 0x6356 0x65CA 0x6820 0x6985
			   0x6AB7 0x6BFF 0x6D46 0x706D 0x1900 0x07C1 0x02E0 0x00BE
			   0x002D 0x0041 0x002F 0x0038 0x0050 0x0096 0x007F 0x007C
			   0x0092 0x0092 0x0092 0x0092 0x005F 0x0143 0x0013 0xFF80
			   0x0000 0x0200 0x049A 0x0680 0x0E4D 0x17E6 0x281A 0x309A
			   0x3600 0x39B3 0x3D33 0x474D 0x4F80 0x5466 0x589A 0x5D1A
			   0x6400 0x6900 0x000A 0x0021 0x0059 0x0159 0x05A7 0x03EE
			   0x0564 0x0498 0x0330 0x01B5 0x0203 0x020F 0x01C2 0x01C2
			   0x01C2 0x01C2 0x02B3 0x00CB 0x6684 0x0000 0x0000 0x0000 >;
	rt,fg_ocv_table3 = <0x0013 0x49C0 0x5000 0x57C1 0x5B7E 0x5C32 0x5CE3 0x5E1B
			   0x5F9C 0x6089 0x6162 0x6277 0x6356 0x65CA 0x6820 0x6985
			   0x6AB7 0x6BFF 0x6D46 0x706D 0x1900 0x07C1 0x02E0 0x00BE
			   0x002D 0x0041 0x002F 0x0038 0x0050 0x0096 0x007F 0x007C
			   0x0092 0x0092 0x0092 0x0092 0x005F 0x0143 0x0013 0xFF80
			   0x0000 0x0200 0x049A 0x0680 0x0E4D 0x17E6 0x281A 0x309A
			   0x3600 0x39B3 0x3D33 0x474D 0x4F80 0x5466 0x589A 0x5D1A
			   0x6400 0x6900 0x000A 0x0021 0x0059 0x0159 0x05A7 0x03EE
			   0x0564 0x0498 0x0330 0x01B5 0x0203 0x020F 0x01C2 0x01C2
			   0x01C2 0x01C2 0x02B3 0x00CB 0x6684 0x0000 0x0000 0x0000 >;
	rt,fg_ocv_table4 = <0x0013 0x49C0 0x5000 0x57C1 0x5B7E 0x5C32 0x5CE3 0x5E1B
			   0x5F9C 0x6089 0x6162 0x6277 0x6356 0x65CA 0x6820 0x6985
			   0x6AB7 0x6BFF 0x6D46 0x706D 0x1900 0x07C1 0x02E0 0x00BE
			   0x002D 0x0041 0x002F 0x0038 0x0050 0x0096 0x007F 0x007C
			   0x0092 0x0092 0x0092 0x0092 0x005F 0x0143 0x0013 0xFF80
			   0x0000 0x0200 0x049A 0x0680 0x0E4D 0x17E6 0x281A 0x309A
			   0x3600 0x39B3 0x3D33 0x474D 0x4F80 0x5466 0x589A 0x5D1A
			   0x6400 0x6900 0x000A 0x0021 0x0059 0x0159 0x05A7 0x03EE
			   0x0564 0x0498 0x0330 0x01B5 0x0203 0x020F 0x01C2 0x01C2
			   0x01C2 0x01C2 0x02B3 0x00CB 0x6684 0x0000 0x0000 0x0000 >;
};

