/*
 * Copyright (C) 2022 Motorola Inc.
 *
 * This program is free software; you can redistribute it and/or modify
 * it under the terms of the GNU General Public License version 2 as
 * published by the Free Software Foundation.
 *
 * This program is distributed in the hope that it will be useful,
 * but WITHOUT ANY WARRANTY; without even the implied warranty of
 * MERCHANTABILITY or FITNESS FOR A PARTICULAR PURPOSE.
 * See http://www.gnu.org/licenses/gpl-2.0.html for more details.
 */
SM5602_NC50_ATL {
	serialnum = "SB18D38324";

	    	//battery,id = <0>;
		battery,param_version = <2>;
	    	battery,max_voltage_uv = <4450000>;
	        battery,battery_type = <4450 0x0 0x275C>;
	    	battery,battery_table0 = <0x1400 0x1B46 0x1C21 0x1D20 0x1D7A 0x1D8B 0x1D91 0x1D9C
                                          0x1DCE 0x1E15 0x1E5A 0x1E87 0x1EC8 0x1F24 0x1FA5 0x1FD3
                                          0x1FFE 0x20C5 0x2172 0x21EC 0x2242 0x22E5 0x232C 0x24CC>;
	    	battery,battery_table1 = <0x0 0x67 0x16B 0x373 0x4FA 0x702 0x90A 0xB95 0xF23 0x16C3
                                          0x1E62 0x2601 0x2DA0 0x3540 0x3A55 0x3CDF 0x3F69 0x4993
                                          0x5132 0x5647 0x59D6 0x60F3 0x6400 0x64E6>;
		battery,battery_table2 = <0x2F56 0x1D23 0x181A 0x1315 0x1112 0x1010 0x0E0F 0x0E0E>;
		battery,alpha = <0x00CC>;
		battery,beta = <0x0025>;
		battery,rs = <0x005F>;
		battery,rs_value = <0x0050 0x010A 0x3800 0x0048>;
		battery,vit_period = <0x315A>;
		battery,volt_cal = <0x8000>;
		battery,mix_value = <0x0003>;
		battery,curr_offset = <0x000>;
		battery,curr_slope = <0x8080>;
		battery,topoff_soc = <7 500>;
		battery,temp_std = <25>;
		battery,temp_offset = <0 11 1 0 8 (-1)>;
		battery,temp_cal = <0 6 1 11 (-1) 0 6 1 9 1>;
		battery,ext_temp_cal = <0 2 1 2 1 1 2 3 2 3>;
		battery,tem_poff = <3400 100>;
	        battery,thermal_table = <0x42B4 0x3DB9 0x38DD 0x340F 0x2F70 0x2ACB 0x2643 0x21C3 0x1D74 0x1913
					0x1515 0x1138 0x0D40 0x0972 0x05AA 0x020C 0xF647 0xF2DB 0xEF92 0xEC36
					0xE90A 0xE5FE 0xE307 0xE027 0xDD5C 0xDAA7 0xD808 0xD57F 0xD30E 0xD0B1
					0xCE65 0xCC30 0xCA0C 0xC7F7 0xC5F7 0xC40E 0xC22F 0xC065 0xBEA9 0xBCF7
					0xBB55 0xB9CC 0xB844 0xB6D0 0xB567 0xB40F 0xB2C1 0xB17E 0xB047 0xAF1C
					0xADFB 0xACE1 0xABD3 0xAAD1 0xA9D8 0xA8E5 0xA7FF 0xA717 0xA640 0xA56F
					0xA4A8 0xA3E5 0xA328 0xA275 0xA1C7 0xA11E 0xA07D 0x9FE2 0x9F4B 0x9EB8
					0x9E28 0x9DA0 0x9D1E 0x9CA1 0x9C27 0x9BB0 0x9B3D 0x9ACF 0x9A65 0x99FE
					0x999B 0x993D 0x98E1 0x9888 0x9830 0x97DC 0x978B 0x973E 0x96F3 0x96AB
					0x9664 0x9621 0x95DF 0x959F 0x9561 0x9524 0x94EA 0x94B3 0x947B 0x9447
					0x9413>;  //NTC value(DEC) table -20~80 (NTC 10k/PU 100k)
};
