## drivers/power/bq2589x_chg_mmi/Kconfig
```kconfig
#
# BQ2589X Charger Driver
#

config BQ2589X_CHARGER
    tristate "TI BQ2589x Charger Driver"
    depends on MMI_DISCRETE_CHARGER_CLASS
    default n
    help
        Say Y here if you have a bq2589x charging device in
        your system.

        To compile this driver as a module, choose M here: the
        module will be called bq2589x_charger.

config BQ2589X_MMI_QC3P_TURBO_CHARGER
    bool "Enable BQ2589X Moto QC3P Turbo Charger"
    depends on BQ2589X_CHARGER
    default n
    help
        Say Y here if you have a BQ2589X Moto QC3P turbo charger compatible device connected.

        If unsure, say N.

config BQ2589X_MMI_QC3P_WT6670_DETECTED
    bool "Enable BQ2589X Moto QC3P WT6670"
    depends on BQ2589X_CHARGER
    default n
    help
        Say Y here if you have a BQ2589X Moto QC3P WT6670 compatible device connected.

        If unsure, say N.
```

## drivers/power/bq2597x_mmi/Kconfig
```kconfig
config BQ2597X_MMI
	tristate "BQ2597X MMI"
	default n
	help
	  Say Y here if you have a bq2597x compatible
	  device connected.

	  This driver can also be built as a module.  If so, the module
	  will be called bq2597x_mmi.

config BQ2597X_DUAL
	bool "BQ2597X DUAL"
	default n
	help
	  Say Y here if you have a bq2597x DUAL compatible
	  device connected.
```

## drivers/power/bq2597x_mmi_iio/Kconfig
```kconfig
config BQ2597X_MMI_IIO
	tristate "BQ2597X MMI IIO"
	default n
	help
	  Say Y here if you have a bq2597x iio compatible
	  device connected.

	  This driver can also be built as a module.  If so, the module
	  will be called bq2597x_mmi_iio.
```

## drivers/power/cps4019_wls_charger/Kconfig
```kconfig
menu "Qualcomm Technologies Inc Charger and Fuel Gauge support"

config CPS_WLS_CHARGER
        bool "CPS wireless charger driver"
        depends on POWER_SUPPLY
        depends on I2C
        help
          Say Y to enable support for CPS wireless charger.

endmenu
```

## drivers/power/cw2217b_fg_mmi/Kconfig
```kconfig
config CW2217B_FG_MMI
    tristate "CW2217 FGADC Device Driver V1.2"
    default n
    help
        Say Y here if you have CW2217 FGADC Device support
        in your system.

        If unsure, say N.

        To compile this driver as a module, choose M here: the
        module will be called cw2217b_fg_mmi.

config DYNAMIC_UPDATE_UI_FULL
    bool "Save the value of CW2217 ui_full to the 0xA2 register"
    depends on CW2217B_FG_MMI
    default n
    help
        Say Y here to save the value of ui_full to the 0xA2 register.

        If unsure, say N.
```

## drivers/power/mmi_charger/Kconfig
```kconfig
config MMI_CHARGER
    tristate "MMI Charger Driver"
    depends on MMI_INFO
    default n
    help
        Say Y here if you have mmi charger support
        in your system.

        If unsure, say N.

        To compile this driver as a module, choose M here: the
        module will be called mmi_charger.

config MMI_RECHARGER_HAWAO_MODE
    bool "Enable MMI Recharger Hawao Mode"
    depends on MMI_CHARGER
    default n
    help
        Say Y here if you have a mmi recharger hawao mode compatible device connected.

        If unsure, say N.
```

## drivers/power/mmi_discrete_charger/Kconfig
```kconfig
config MMI_DISCRETE_CHARGER
    tristate "MMI Discrete Charger Driver"
    depends on ADAPTER_CLASS && MMI_CHARGER
    default n
    help
        Say Y here if you have mmi discrete charger support
        in your system.

        If unsure, say N.

        To compile this driver as a module, choose M here: the
        module will be called mmi_discrete_charger.

config MMI_DISCRETE_CHARGER_CLASS
    tristate "MMI Discrete Charger Class Device"
    default n
    help
        Say Y here if you have mmi discrete charger class support
        in your system.

        If unsure, say N.

        To compile this driver as a module, choose M here: the
        module will be called mmi_discrete_charger_class.
```

## drivers/power/mmi_discrete_turbo_charger/Kconfig
```kconfig
config MMI_DISCRETE_TURBO_CHARGER
    tristate "MMI Discrete Turbo Charger Driver"
    depends on ADAPTER_CLASS && MMI_CHARGER
    default n
    help
        Say Y here if you have mmi discrete turbo charger support
        in your system.

        If unsure, say N.

        To compile this driver as a module, choose M here: the
        module will be called mmi_discrete_turbo_charger.
```

## drivers/power/mmi_parallel_charger/Kconfig
```kconfig
config MMI_PARALLEL_CHARGER
	tristate "MMI PARALLEL CHARGER"
	default n
	help
	  Say Y here if you have a mmi parallel charger compatible
	  device connected.

	  This driver can also be built as a module.  If so, the module
	  will be called mmi_parallel_charger.
```

## drivers/power/mmi_parallel_charger_qc3p/Kconfig
```kconfig
config MMI_PARALLEL_CHARGER_QC3P
	tristate "MMI PARALLEL CHARGER QC3P"
	default n
	help
	  Say Y here if you have a mmi parallel charger compatible
	  device connected.

	  This driver can also be built as a module.  If so, the module
	  will be called mmi_parallel_charger_qc3p.
```

## drivers/power/mmi_qc3p_wt6670f/Kconfig
```kconfig
config MMI_QC3P_WT6670F
    tristate "MMI QC3P WT6670F Driver"
    depends on ADAPTER_CLASS && MMI_CHARGER
    default n
    help
        Say Y here if you have mmi qc3p wt6670f support
        in your system.

        If unsure, say N.

        To compile this driver as a module, choose M here: the
        module will be called mmi_qc3p_wt6670f.

config MMI_QC3P_WT6670_DETECTED
    bool "Enable MMI QC3P WT6670 detection"
    depends on MMI_QC3P_WT6670F
    default n
    help
        Say Y here to enable mmi QC3P WT6670 detection.

        If unsure, say N.

config MMI_QC3P_Z350_DETECTED
    bool "Enable MMI QC3P Z350 detection"
    depends on MMI_QC3P_WT6670F
    default n
    help
        Say Y here to enable mmi QC3P Z350 detection.

        If unsure, say N.

config MMI_QC3P_TURBO_CHARGER
    bool "Enable MMI QC3P Turbo Charger"
    default n
    help
        Say Y here to enable mmi QC3P Turbo Charger.

        If unsure, say N.

config MMI_QC3P_TURBO_CHARGER_ISP_5G
    bool "Enable MMI QC3P Turbo Charger ISP 5G"
    default n
    help
        Say Y here to enable mmi QC3P Turbo Charger ISP 5G.

        If unsure, say N.
```

## drivers/power/p938x_charger/Kconfig
```kconfig
config P938X_CHARGER
	tristate "P938X Charger Driver"
	help
	  Say Y here if you have P938X Charging Device in
          your system.

	  If unsure, say N.

	  To compile this driver as a module, choose M here: the
	  module will be called p938x_charger.
```

## drivers/power/qpnp-smbcharger-mmi/Kconfig
```kconfig
config QPNP_SMBCHARGER_MMI
	tristate "QPNP SMBCHARGER MMI"
	default n
	help
	  Say Y here if you have a qpnp smbcharger mmi compatible
	  device connected.

	  This driver can also be built as a module.  If so, the module
	  will be called qpnp_smbcharger_mmi.

config PD_CHARGER_MMI
	bool "PD CHARGER MMI"
	depends on QPNP_SMBCHARGER_MMI
	default n
	help
	  Say Y here if you have a PDO compatible device connected.

	  If unsure, say N.
```

## drivers/power/qpnp_adaptive_charge/Kconfig
```kconfig
config QPNP_ADAPTIVE_CHARGE
        tristate "QPNP ADAPTIVE CHARGE"
        default n
        help
         Say Y here if you have a qpnp adaptive charge compatible device
         connected.

         This driver can also be built as a module. If so, the module will be
         called qpnp_adaptive_charge.

config ADAPTIVE_TOLERANCE_OPTIMIZATION
        bool "Adaptive charger tolerance optimization"
        depends on QPNP_ADAPTIVE_CHARGE
        default n
        help
         Say Y here if you want adaptive charger tolerance optimization from 1
         to 2 for more stable state switching.
```

## drivers/power/rt9471_chg_mmi/Kconfig
```kconfig
config RT9471_CHG_MMI
    tristate "MMI RT9471 Charger Driver"
    depends on ADAPTER_CLASS && MMI_CHARGER
    default n
    help
        Say Y here if you have mmi rt9471 support
        in your system.

        If unsure, say N.

        To compile this driver as a module, choose M here: the
        module will be called rt9471_charger.
```

## drivers/power/sgm4154x_chg_mmi/Kconfig
```kconfig
#
# SGM4154X Charger driver
#

config SGM4154X_CHARGER
    tristate "sgm4154x charger driver"
    depends on MMI_DISCRETE_CHARGER_CLASS
    default n
    help
        Say Y here if you have a sgm415x charging device in
        your system.

        To compile this driver as a module, choose M here: the
        module will be called sgm415x_charger.

config MMI_SGM41513_CHARGER
    bool "Enable SGM4154X Moto SGM41513 Charger"
    depends on SGM4154X_CHARGER
    default n
    help
        Say Y here if you have a SGM4154X Moto SGM41513 Charger compatible device connected.

        If unsure, say N.
```

## drivers/power/sm5602_fg_mmi/Kconfig
```kconfig
config SM5602_FQ_MMI
    tristate "SM SM5602 Fuel Gauge Driver"
    default n
    help
        Say Y here if you have SM SM5602 Fuel Gauge support
        in your system.

        If unsure, say N.

        To compile this driver as a module, choose M here: the
        module will be called sm5602_fg_mmi.
```

## drivers/regulator/slg51000/Kconfig
```kconfig
config REGULATOR_SLG51000
        tristate "SLG51000 REGULATOR"
        default n
        help
         Say Y here if you have a SLG51000 compatible
         device connected.

         This driver can also be built as a module.  If so, the module
         will be called slg51000-regulator.
```

## drivers/regulator/wl2864c/Kconfig
```kconfig
config REGULATOR_WL2864C
        tristate "WL2864C REGULATOR"
        default n
        help
         Say Y here if you have a WL2864C compatible
         device connected.

         This driver can also be built as a module.  If so, the module
         will be called wl2864c-regulator.
```

## drivers/regulator/wl2866d/Kconfig
```kconfig
config REGULATOR_WL2866D
        tristate "WL2866D REGULATOR"
        default n
        help
         Say Y here if you have a WL2866D compatible
         device connected.

         This driver can also be built as a module.  If so, the module
         will be called wl2866d-regulator.
```

## drivers/tzlog_dump/Kconfig
```kconfig
config TZLOG_DUMP
        tristate "TZLOG DUMP"
        default n
        help
         Say Y here if you have a tzlog compatible
         device defined.

         This driver can also be built as a module.  If so, the module
         will be called tzlog_dump.
```

## drivers/usb/typec/adapter_class/Kconfig
```kconfig
config ADAPTER_CLASS
    tristate "Adapter Class Device Driver"
    default n
    help
        Say Y here if you have Adapter Class Device support
        in your system.

        If unsure, say N.

        To compile this driver as a module, choose M here: the
        module will be called adapter_class.
```

## drivers/usb/typec/mmi_tcpc/Kconfig
```kconfig
config TCPC_CLASS
    tristate "TypeC Port Control Class"
    default n
    help
        Say Y here if you have TCPC class support
        in your system.

        If unsure, say N.

        To compile this driver as a module, choose M here: the
        module will be called tcpc_class.

config USB_POWER_DELIVERY
    bool "Enable USB Power Delivery"
    depends on TCPC_CLASS && ADAPTER_CLASS
    default n
    help
        Say Y here if you have a usb power delivery compatible device connected.

        If unsure, say N.

config TCPC_RT1711H
    tristate "RT1711 TCPC Driver"
    default n
    help
        Say Y here if you have RT1711 TypeC Port Control support
        in your system.

        If unsure, say N.

        To compile this driver as a module, choose M here: the
        module will be called tcpc_rt1711h.

config TCPC_SGM7220
    tristate "SGM7220 TCPC Driver"
    default n
    help
        Say Y here if you have SGM7220 TypeC Port Control support
        in your system.

        If unsure, say N.

        To compile this driver as a module, choose M here: the
        module will be called tcpc_sgm7220.

config RT_PD_MANAGER
    tristate "Richtek pd manager driver"
    default n
    help
        Say Y here if you have Richtek pd manager driver support
        in your system.

        If unsure, say N.

        To compile this driver as a module, choose M here: the
        module will be called rt_pd_manager.
```

## drivers/watchdog_cpu_ctx/Kconfig
```kconfig
config WATCHDOG_CPU_CTX
        tristate "WATCHDOG CPU CTX"
        default n
        help
         Say Y here if you have a watchdog cpu ctx compatible
         device defined.

         This driver can also be built as a module.  If so, the module
         will be called watchdog_cpu_ctx.
```

## drivers/watchdogtest/Kconfig
```kconfig
config WATCHDOGTEST
        tristate "WATCHDOGTEST"
        default n
        help
         Say Y here if you have a WATCHDOGTEST compatible
         device defined.

         This driver can also be built as a module.  If so, the module
         will be called watchdogtest.
```
