## drivers/input/touchscreen/nova_0flash_mmi/Kconfig
```kconfig
#
# Novatek NT36xxx touchscreen driver configuration
#
menuconfig TOUCHSCREEN_NT36xxx_HOSTDL_SPI_MMI
	tristate "Moto Novatek NT36xxx host download SPI driver"
	default n
	help
	  Say Y here if you have a Moto Novatek NT36xxx no flash touchscreen
	  connected to your system by SPI bus.

	  If unsure, say N.

if TOUCHSCREEN_NT36xxx_HOSTDL_SPI_MMI

config INPUT_NOVA_0FLASH_MMI_ENABLE_DOUBLE_TAP
	bool "Moto Novatek NT36xxx Double tap"
	depends on SENSORS_CLASS
	default n
	help
	  Say Y here if you want to have Double tap support on Moto Novatek
	  NT36xxx.

	  If unsure, say N.

config INPUT_NOVA_0FLASH_MMI_NOTIFY_TOUCH_STATE
	bool "Moto Novatek NT36xxx notify touch state"
	default n
	help
	  Say Y here if you want to have Double tap support on Moto Novatek
	  NT36xxx.

	  If unsure, say N.

config INPUT_NOVA_PANEL_NOTIFICATIONS
	bool "Moto Novatek NT36xxx panel notification"
	default n
	help
	  Say Y here if you want to have panel notification support on Moto
	  Novatek NT36xxx.

	  If unsure, say N.

config INPUT_NOVA_DRM_PANEL
	bool "Moto Novatek NT36xxx touch DRM panel"
	default n
	help
	  Say Y here if you want to have touch DRM panel support on Moto
	  Novatek NT36xxx.

	  If unsure, say N.

config INPUT_NOVA_CHIP_VER_1
	bool "Moto Novatek NT36xxx touch chip ver 1"
	default n
	help
	  Say Y here if you want to have touch chip ver 1 support on Moto
	  Novatek NT36xxx.

	  If unsure, say N.

config NOVA_ESD_ENABLE
	bool "Moto Novatek NT36xxx ESD Detection"
	default n
	help
	  Say Y here if you want to have ESD Detection support on Moto Novatek
	  NT36xxx.

	  If unsure, say N.

config NOVA_LCM_FAST_LIGHTUP
	bool "Moto Novatek NT36xxx lcm fast lightup"
	default n
	help
	  Say Y here if you want to have lcm fast lightup support on Moto
	  Novatek NT36xxx.

	  If unsure, say N.

config INPUT_NOVA_0FLASH_MMI_STYLUS_PALM
	bool "Moto Novatek NT36xxx stylus palm"
	default n
	help
	  Say Y here if you want to have stylus palm support on Moto Novatek
	  NT36xxx.

	  If unsure, say N.

config INPUT_NOVA_0FLASH_MMI_STYLUS_PALM_RANGE
	bool "Moto Novatek NT36xxx stylus palm range"
	default n
	help
	  Say Y here if you want to have stylus palm range support on Moto
	  Novatek NT36xxx.

	  If unsure, say N.

# config INPUT_NOVA_0FLASH_MMI_PEN_NOTIFIER
# 	bool "Moto Novatek NT36xxx pen notifier"
# 	depends on PEN_BU520XX
# 	default n
# 	help
# 	  Say Y here if you want to have pen notifier support on Moto Novatek
# 	  NT36xxx.

# 	If unsure, say N.

config INPUT_NOVA_EDGE_SUPPRESSION
	bool "Moto Novatek NT36xxx EDGE touch suppression"
	default n
	help
	  Say Y here if you want to have EDGE touch suppression support on Moto
	  Novatek NT36xxx.

	  If unsure, say N.

endif
```

## drivers/input/touchscreen/pixart_mmi/Kconfig
```kconfig
#
# PixArt TOUCH driver configuration
#

config TOUCHSCREEN_PIXART_TS
        tristate "PixArt Touchscreen"
        depends on I2C
        help
          Say Y here if you want support for PCT1812 touchscreen controller.
          If unsure, say N.

          To compile this driver as a module, choose M here: the
          module will be called pct1812_mmi.
```

## drivers/input/touchscreen/stmicro_mmi/Kconfig
```kconfig
#
# STmicro TOUCH driver configuration
#

config TOUCHSCREEN_FTS_TS
        tristate "STmicro Touchscreen"
        depends on I2C
        depends on INPUT_TOUCHSCREEN_MMI || !INPUT_TOUCHSCREEN_MMI
        help
          Say Y here if you want support for FTS touchscreen controllers.
          If unsure, say N.

          To compile this driver as a module, choose M here: the
          module will be called stmicro_mmi.

config ST_LIMIT_USE_SUPPLIER
        bool ""
        depends on TOUCHSCREEN_FTS_TS
```

## drivers/input/touchscreen/synaptics_tcm2_mmi/Kconfig
```kconfig
#
# Synaptics TCM touchscreen driver configuration
#
menuconfig TOUCHSCREEN_SYNA_TCM2
	tristate "Synaptics TCM touchscreen"
	default n
	help
	  Say Y here if you have a Synaptics TCM touchscreen connected
	  to your system.

	  If unsure, say N.

	  To compile this driver as a module, choose M here.

if TOUCHSCREEN_SYNA_TCM2

config TOUCHSCREEN_SYNA_TCM2_SYSFS
	bool "Synaptics TCM device sysfs module"
	depends on TOUCHSCREEN_SYNA_TCM2
	help
	  Say Y here to enable support for the sysfs interface.

	  If unsure, say N.

config TOUCHSCREEN_SYNA_TCM2_REFLASH
	bool "Synaptics TCM reflash module"
	depends on TOUCHSCREEN_SYNA_TCM2
	help
	  Say Y here to enable support for the reflashing.

	  If unsure, say N.

config TOUCHSCREEN_SYNA_TCM2_TESTING
	bool "Synaptics TCM testing module"
	depends on TOUCHSCREEN_SYNA_TCM2
	help
	  Say Y here to enable support for the production test.

	  If unsure, say N.

config TOUCHSCREEN_SYNA_TCM2_ROMBOOT
	bool "Synaptics TCM rom-bootloader module"
	depends on TOUCHSCREEN_SYNA_TCM2
	help
	  Say Y here to enable support for the rom-boot access.

	  If unsure, say N.

endif
```

## drivers/input/touchscreen/touchscreen_mmi/Kconfig
```kconfig
config INPUT_TOUCHSCREEN_MMI
	tristate "Moto touchscreen gestures"
	depends on SENSORS_CLASS && MMI_RELAY
	default n
	help
	 Say Y here if you wish to include support for Moto touchscreen gestures.
	 If unsure, say N.

if INPUT_TOUCHSCREEN_MMI

config TOUCHCLASS_MMI_DEBUG_INFO
	bool "Moto touchscreen gestures debug info"
	default n
	help
	 Say Y here if you wish to include support for Moto touchscreen gestures debugging info.
	 If unsure, say N.

config TOUCHCLASS_MMI_GESTURE_POISON_EVENT
	bool "Moto gestures event poison"
	default n
	help
	 Say Y here if you wish to include support for Moto gestures event poison.
	 If unsure, say N.

config TOUCHCLASS_MMI_MULTIWAY_UPDATE_FW
	bool "Moto TP firmware through the Parameter APK"
	default n
	help
	  Say Y here if you want to have TP firmware through the Parameter APK.
	  If unsure, say N.

config DRM_PANEL_NOTIFICATIONS
	bool "Moto DRM panel notifications"
	default n
	help
	 Say Y here if your panel includes support for drm notifications.
	 If unsure, say N.

config DRM_PANEL_EVENT_NOTIFICATIONS
	bool "Moto DRM panel event notifications"
	default n
	help
	 Say Y here if your panel includes support for drm panel event notifications.
	 If unsure, say N.

config DRM_DYNAMIC_REFRESH_RATE
	bool "Moto DRM dynamic refresh rate"
	default n
	help
	 Say Y here if your panel includes support for drm dynamic refresh rate.
	 If unsure, say N.

config BOARD_USES_DOUBLE_TAP_CTRL
	bool "Moto double tap control"
	default n
	help
	 Say Y here if your panel includes support for double tap control.
	 If unsure, say N.

config GTP_DDA_STYLUS
	bool "Moto GTP DDA stylus"
	default n
	help
	 Say Y here if your panel includes support for GTP DDA stylus.
	 If unsure, say N.

endif
```

## drivers/media/platform/msm/camera/cam_sensor_module/cam_cci/Kconfig
```kconfig
config CAMERA_CCI_DEBUG_INTF
    tristate "Camera CCI DEBUG INTF"
    default n
    help
        Say Y here if you wish to include Camera CCI DEBUG INTF.

        If unsure, say N.

        To compile this driver as a module, choose M here: the
        module will be called cci_intf.
```

## drivers/misc/abov_mmi_overlay/Kconfig
```kconfig
config ABOV_SAR_MMI_OVERLAY
	tristate "ABOV SAR MMI OVERLAY"
	help
	  Say Y here if you have a abov sar compatible
	  device connected.

	  This driver can also be built as a module. If so, the module
	  will be called abov_sar_mmi_overlay.
```

## drivers/misc/aw9610x/Kconfig
```kconfig
config AW9610X_SAR
    tristate "AW9610X SAR Driver"
    depends on SENSORS_CLASS
    help
        Say Y here if you have Aw9610x Sar Sensor Device in
        your system.

        If unsure, say N.

        To compile this driver as a module, choose M here: the
        module will be called aw9610x.

config AW9610X_POWER_SUPPLY_ONLINE
    bool "Enable Aw9610x power supply online usage"
    depends on AW9610X_SAR
    help
        Enable online power supply usage.
```

## drivers/misc/awinic/Kconfig
```kconfig
#
# Awinic Haptic
#

menuconfig INPUT_AWINIC_HAPTIC
	bool "Awinic Haptic"
	default n
	help
	  Enables Awinic Haptic driver.

source "drivers/misc/awinic/aw8695/Kconfig"
```

## drivers/misc/awinic/aw8695/Kconfig
```kconfig
#
# AW8695 Driver
#

config AW8695_HAPTIC
	tristate "Awinic AW8695 haptic driver"
	depends on I2C && INPUT_AWINIC_HAPTIC
	help
	  Say Y here if you have Awinic AW8695 haptic controller
	  chip in your system.

	  If unsure, say N.

	  To compile this driver as a module, choose M here: the
	  module will be called aw8695.

config AW8965_VIBRATOR_SHORT_WAV_ENABLE
	bool "Awinic AW8695 short wave"
	default n
	help
	  Say Y here if your Awinic AW8695 supports short wave.
	  If unsure, say N.
```

## drivers/misc/awinic/aw869xx/Kconfig
```kconfig
#
# Mediatek AW869XX Driver
#

config AW869XX_HAPTIC
	tristate "Awinic AW869XX haptic driver"
	depends on I2C
	help
	  Say Y here if you have Awinic AW869XX haptic controller
	  chip in your system.
	  If unsure, say N.
	  To compile this driver as a module, choose M here: the
	  module will be called awinic_haptic.
```

## drivers/misc/dts201a/Kconfig
```kconfig
config DTS201A_MMI
	tristate "DTS201A_MMI"
	help
	  Say Y here if you have a dts201a compatible
	  device connected.

	  This driver can also be built as a module. If so, the module
	  will be called dts201a_mmi.

config FEATURE_USE_CCI
	bool "Feature Use CCI"
	depends on DTS201A_MMI
	help
	  This enables support for Feature use CCI.
```

## drivers/misc/ldo_vibrator_mmi/Kconfig
```kconfig
config LDO_VIBRATOR_MMI
    tristate "EXT Vibrator-LDO driver"
    help
        Say Y here if you have EXT Vibrator-LDO Device in
        your system.

        If unsure, say N.

        To compile this driver as a module, choose M here: the
        module will be called ldo_vibrator_mmi.
```

## drivers/misc/mmi_sys_temp/Kconfig
```kconfig
#
# UTAGS Driver
#

config MMI_SYS_TEMP
	tristate "MMI sys temp driver"
	help
	  Say Y here if you have mmi_sys_temp
	  support in your system.

	  If unsure, say N.

	  To compile this driver as a module, choose M here: the
	  module will be called mmi_sys_temp.
```

## drivers/misc/regulator_vibrator_mmi/Kconfig
```kconfig
config REGULATOR_VIBRATOR_MMI
    tristate "EXT Vibrator-LDO driver"
    help
        Say Y here if you have EXT Vibrator-LDO Device in
        your system.

        If unsure, say N.

        To compile this driver as a module, choose M here: the
        module will be called regulator_vibrator_mmi.

config VIBRATOR_NOISE_CAMERA
    bool "Enable Vibrator Noise Camera"
    depends on REGULATOR_VIBRATOR_MMI
    help
        Enable Vibrator Noise Camera.
```

## drivers/misc/sx933x/Kconfig
```kconfig
#
# CapSense(TM) devices
#

config SARSENSOR_SX933X
	tristate "sx933x Programming Driver"
	depends on I2C
	help
	  CapSense devices is the analog system contains the capacitive sensing
	  hardware. Several hardware algorithms are supported. This hardware
	  performs capacitive sensing and scanning without requiring external
	  components. It contains internal flash memory, which have to be programmed
	  with firmware using HSSP interface. Host Sourced Serial Programming (HSSP)
	  refers to the programming of the target device on the board by using a host
	  microcontroller. The PSoC 4 target is programmed through the SWD interface -
	  ARM Serial Ware Debug. This option enables firmware programming driver and
	  allows automatically identify device and matching firmware. See file
	  Documentation/devicetree/bindings/misc/capsense_hssp.txt for details.

config SX933X_USB_CAL
	bool "Enable sx933x usb calibration"
	depends on SARSENSOR_SX933X
	help
	  Enable Cap-sensor calibration when usb plug.

	  To use SX933X_USB_CAL open the feature that it can enable cap-sensor calibration
	  when usb plug.

config SX933X_FLIP_CAL
	bool "Enable sx933x flip calibration"
	depends on SARSENSOR_SX933X
	help
	  Enable Cap-sensor calibration when flipping.

	  To use SX933X_FLIP_CAL open the feature that it can enable cap-sensor calibration
	  when flipping.

config SX933X_ATTACH_CAL
	bool "Enable sx933x attach calibration"
	depends on SARSENSOR_SX933X
	help
	  Enable Cap-sensor calibration when attaching.

	  To use SX933X_ATTACH_CAL open the feature that it can enable cap-sensor calibration
	  when attaching.

config SX933X_HEADSET_STATE
	bool "Enable sx933x headset state"
	depends on SARSENSOR_SX933X
	help
	  Enable Cap-sensor headset state.
```

## drivers/misc/sx937x/Kconfig
```kconfig
#
# CapSense(TM) devices
#

config SARSENSOR_SX937X
	tristate "sx937x Programming Driver"
	depends on I2C
	help
	  CapSense devices is the analog system contains the capacitive sensing
	  hardware. Several hardware algorithms are supported. This hardware
	  performs capacitive sensing and scanning without requiring external
	  components. It contains internal flash memory, which have to be programmed
	  with firmware using HSSP interface. Host Sourced Serial Programming (HSSP)
	  refers to the programming of the target device on the board by using a host
	  microcontroller. The PSoC 4 target is programmed through the SWD interface -
	  ARM Serial Ware Debug. This option enables firmware programming driver and
	  allows automatically identify device and matching firmware. See file
	  Documentation/devicetree/bindings/misc/capsense_hssp.txt for details.

config SX937X_USB_CAL
	bool "Enable sx937x usb calibration"
	depends on SARSENSOR_SX937X
	help
	  Enable Cap-sensor calibration when usb plug.

	  To use SX937X_USB_CAL open the feature that it can enable cap-sensor calibration
	  when usb plug.

config SX937X_FLIP_CAL
	bool "Enable sx937x flip calibration"
	depends on SARSENSOR_SX937X
	help
	  Enable Cap-sensor calibration when flipping.

	  To use SX937X_FLIP_CAL open the feature that it can enable cap-sensor calibration
	  when flipping.

config SX937X_POWER_SUPPLY_ONLINE
	bool "Enable sx937x power supply online usage"
	depends on SARSENSOR_SX937X
	help
	  Enable online power supply usage.

config CAPSENSE_HEADSET_STATE
	bool "Enable sx937x headset state"
	depends on SARSENSOR_SX937X
	help
	  Enable Cap-sensor headset state.
```

## drivers/misc/tps61280/Kconfig
```kconfig
config TPS61280
	tristate "TI TPS61280 configuration"
	depends on I2C
	select REGMAP_I2C
	default n
	help
	  This driver supports TPS61280 voltage regulator chip. This
	  driver is meant for basic configuration only and does not provide
	  any pm/regulator/thermal framework registration.
```

## drivers/misc/utag/Kconfig
```kconfig
#
# UTAGS Driver
#

config MOTO_UTAGS
	tristate "Moto UTAGS driver"
	help
	  Say Y here if you have UTAGS
	  defined in your system.

	  If unsure, say N.

	  To compile this driver as a module, choose M here: the
	  module will be called utags.
```

## drivers/mmi_annotate/Kconfig
```kconfig
config MMI_ANNOTATE
        tristate "MMI ANNOTATE"
        default n
        help
         Say Y here if you have a mmi annotate compatible
         device connected.

         This driver can also be built as a module.  If so, the module
         will be called mmi_annotate.
```

## drivers/mmi_info/Kconfig
```kconfig
config MMI_INFO
        tristate "MMI INFO"
        default n
	depends on MMI_ANNOTATE
        help
         Say Y here if you have a mmi info compatible
         device connected.

         This driver can also be built as a module.  If so, the module
         will be called mmi_info.
```

## drivers/mmi_relay/Kconfig
```kconfig
config MMI_RELAY
        tristate "MMI RELAY"
        default n
        help
         Say Y here if you have a mmi relay compatible
         device connected.

         This driver can also be built as a module.  If so, the module
         will be called mmi_relay.
```
