## drivers/moto_f_usbnet/Kconfig
```kconfig
config MOTO_F_USBNET
        tristate "Moto USBNET Extension"
        default n
        help
         Say Y here if you have a MOTO F USBNET compatible
         device defined.

         This driver can also be built as a module.  If so, the module
         will be called f_usbnet.
```

## drivers/nfc/st21nfc/Kconfig
```kconfig
config NFC_ST21NFC
        tristate "ST21NFC NFC"
        default n
        help
         Say Y here if you have a ST21NFC compatible
         chip.

         This driver can also be built as a module. If so, the module
         will be called st21nfc.
```

## drivers/power/Kconfig
```kconfig
source "drivers/power/avs/Kconfig"
source "drivers/power/reset/Kconfig"
source "drivers/power/supply/Kconfig"
source "drivers/power/p938x_charger/Kconfig"
source "drivers/power/qpnp_adaptive_charge/Kconfig"
source "drivers/power/qpnp-smbcharger-mmi/Kconfig"
source "drivers/power/mmi_parallel_charger/Kconfig"
source "drivers/power/mmi_parallel_charger_qc3p/Kconfig"
source "drivers/power/bq2597x_mmi/Kconfig"
```
