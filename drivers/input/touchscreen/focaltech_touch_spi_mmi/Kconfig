## drivers/input/touchscreen/focaltech_touch_spi_mmi/Kconfig
```kconfig
#
# Focaltech Touchscreen driver configuration
#

config INPUT_TOUCHSCREEN_FOCALTECH_SPI_MMI
    tristate "FocalTech Touchscreen Driver SPI MMI"
    default n
    help
      Say Y here if you wish to include support for FocalTech Touchscreen SPI MMI.
      If unsure, say N.
      To compile this driver as a module, choose M here: the
      module will be called focaltech_touch_spi_mmi.
```
