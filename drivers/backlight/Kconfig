## drivers/backlight/Kconfig
```kconfig
source "drivers/backlight/aw99703/Kconfig"

source "drivers/backlight/ktd3136/Kconfig"

source "drivers/backlight/lm3697/Kconfig"
```

## drivers/backlight/aw99703/Kconfig
```kconfig
config LEDS_AW99703
	tristate "AW99703 LED driver"
	default n
	help
	  Say Y here if you have AW99703 LED in
	  your system.

	  If unsure, say N.

	  To compile this driver as a module, choose M here: the
	  module will be called leds_aw99703.
```

## drivers/backlight/ktd3136/Kconfig
```kconfig
config KTD3136_BL
	tristate "KTD3136 BL driver"
	default n
	help
	  Say Y here if you have KTD3136 BL in
	  your system.

	  If unsure, say N.

	  To compile this driver as a module, choose M here: the
	  module will be called ktd3136_bl.
```

## drivers/backlight/lm3697/Kconfig
```kconfig
config LEDS_LM3697
	tristate "LM3697 LED driver"
	default n
	help
	  Say Y here if you have LM3697 LED in
	  your system.

	  If unsure, say N.

	  To compile this driver as a module, choose M here: the
	  module will be called leds_lm3697.
```

## drivers/gud/MobiCoreDriver/Kconfig
```kconfig
#
# MobiCore configuration
#

config MOBICORE_SUPPORT
	tristate "Linux MobiCore Support"
	default n
	help
	  Enable Linux Kernel MobiCore Support

config MOBICORE_RSU_INTERNAL_CLOCK
	bool "MobiCore RSU internal clock"
	depends on MOBICORE_SUPPORT
	default n
	help
	  Enable RSU internal clock in the MobiCore Driver.
```

## drivers/input/misc/chipone_fps_mmi/Kconfig
```kconfig
config INPUT_CHIPONE_FPS_MMI
    tristate "Fingerprint chip TEE driver"
    default n
    help
        Say Y here if you wish to include support for MMI Chipone finger print sensor.

        If unsure, say N.

        To compile this driver as a module, choose M here: the
        module will be called fpsensor_spi_tee.

config INPUT_CHIPONE_FPS_SUPPORT_POWER_GPIO
    bool "Enable Chipone fingerprint sensor power GPIO"
    depends on INPUT_CHIPONE_FPS_MMI
    default n
    help
        Say Y here if you wish to include support for MMI Chipone finger print sensor
        power GPIO.

        If unsure, say N.
```

## drivers/input/misc/ets_bix_mmi/Kconfig
```kconfig
config INPUT_EGISTEC_BIX
	tristate "Egistec fingerprint sensor BIX MMI"
	default n
	help
	 Say Y here if you wish to include support for BIX MMI EGIS finger print sensor.
	 If unsure, say N.
```

## drivers/input/misc/ets_fps_mmi/Kconfig
```kconfig
config INPUT_EGISTEC_FPS
	tristate "Egistec fingerprint sensor MMI"
	default n
	help
	 Say Y here if you wish to include support for MMI EGIS finger print sensor.
	 If unsure, say N.

menuconfig INPUT_EGISTEC_FPS_NAVI
	bool "Egistec fingerprint sensor MMI navigation support"
        depends on INPUT_EGISTEC_FPS
	default n
	help
	 Say Y here if you wish to include support for MMI EGIS finger print sensor
         navigation functions.
	 If unsure, say N.

if INPUT_EGISTEC_FPS_NAVI

config INPUT_EGISTEC_FPS_NAVI_VERTICAL
	bool "Egistec fingerprint sensor MMI navigation vertical support"
	default y
	help
	 Say Y here if you wish to include support for MMI EGIS finger print sensor
         vertical navigation functions.
	 If unsure, say N.

config INPUT_EGISTEC_FPS_NAVI_HORIZON
	bool "Egistec fingerprint sensor MMI navigation horizon support"
	default y
	help
	 Say Y here if you wish to include support for MMI EGIS finger print sensor
         horizon navigation functions.
	 If unsure, say N.

endif

config EGIS_DISPLAY_SPEED_UP
	bool "Egistec fingerprint sensor display speed up support"
        depends on INPUT_EGISTEC_FPS
	default n
	help
	 Say Y here if you wish to include support for MMI EGIS finger print sensor
         display speed up functions.
	 If unsure, say N.

config NAV_DOUBLE_TAP
        bool "Egistec fingerprint sensor MMI double click support"
        depends on INPUT_EGISTEC_FPS
        default n
        help
         Say Y here if you wish to include support for MMI EGIS finger print sensor
         double click functions.

 choice
	prompt "Egistec fingerprint sensor pose"
        depends on INPUT_EGISTEC_FPS
	default INPUT_EGISTEC_FPS_POSE_270

	config INPUT_EGISTEC_FPS_POSE_0
		bool "0 degree"

	config INPUT_EGISTEC_FPS_POSE_90
		bool "90 degree"

	config INPUT_EGISTEC_FPS_POSE_180
		bool "180 degree"

	config INPUT_EGISTEC_FPS_POSE_270
		bool "270 degree"
endchoice

config INPUT_EGISTEC_FPS_POSE
	int
	default 0 if INPUT_EGISTEC_FPS_POSE_0
	default 90 if INPUT_EGISTEC_FPS_POSE_90
	default 180 if INPUT_EGISTEC_FPS_POSE_180
	default 270 if INPUT_EGISTEC_FPS_POSE_270
```

## drivers/input/misc/focal_fps_mmi/Kconfig
```kconfig
config INPUT_FOCAL_FPS
	tristate "FocalTech fingerprint sensor"
	default n
	help
	 Say Y here if you wish to include support for FocalTech finger print sensor.
	 If unsure, say N.
```

## drivers/input/misc/fpc_fps_mmi/Kconfig
```kconfig
config INPUT_MISC_FPC1020
	tristate "FPC fingerprint sensor MMI"
	default n
	help
	 Say Y here if you wish to include support for MMI FPC finger print sensor.
	 If unsure, say N.

config INPUT_MISC_FPC1020_SAVE_TO_CLASS_DEVICE
	bool "FPC fingerprint sensor MMI sysfs support"
	default n
	depends on INPUT_MISC_FPC1020
	help
	 Say Y here if you wish to include support for MMI FPC finger print sensor
         sysfs.
	 If unsure, say N.
```

## drivers/input/misc/goodix_fod_mmi/Kconfig
```kconfig
config INPUT_GOODIX_FOD_MMI
	tristate "Goodix fingerprint sensor MMI"
	default n
	help
	 Say Y here if you wish to include support for MMI Goodix finger print sensor.
	 If unsure, say N.

config INPUT_GOODIX_FOD_MMI_RELAY
	bool "Goodix fingerprint Additional dependencies MMI"
	depends on INPUT_GOODIX_FOD_MMI
	default n
	help
	 Say Y here if you wish to include support for MMI Goodix finger print sensor.
	 If unsure, say N.

config INPUT_GOODIX_FOD_GPIO_PCAL6408
	bool "Goodix fingerprint senor softdep gpio PCAL6408 MMI"
	depends on INPUT_GOODIX_FOD_MMI
	default n
	help
	 Say Y here if you wish to include support for MMI Goodix finger print sensor.
	 If unsure, say N.
```

## drivers/input/misc/qpnp_power_on_mmi/Kconfig
```kconfig
config INPUT_QPNP_POWER_ON_MMI
        tristate "QPNP PMIC Power-on MMI support"
        depends on SPMI
        help
          This option enables device driver support for the power-on
          functionality of Qualcomm Technologies, Inc. PNP PMICs.  It supports
          reporting the change in status of the KPDPWR_N line (connected to the
          power-key) as well as reset features.
```

## drivers/input/misc/rbs_fps_mmi/Kconfig
```kconfig
config INPUT_EGIS_FPS
    tristate "egis fingerprint driver"
    default n
    help
        Say Y here if you wish to include support for MMI EGIS finger print sensor.

        If unsure, say N.

        To compile this driver as a module, choose M here: the
        module will be called rbs_fps_mmi.
```

## drivers/input/misc/vl53L1/Kconfig
```kconfig
config INPUT_STMVL53L1
	tristate "STMVL53L1 support"
	default n
	help
	  Say Y here if you wish to include support for laser sensor driver.

config INPUT_MISC_TOF_USE_VL53L3
	bool "STMVL53L3 support"
	depends on INPUT_STMVL53L1
	default n
	help
	  Say Y here if you wish to include support for VL53L3 laser sensor driver.

config INPUT_MISC_PMIC_WL2864C
	bool "WL2864C support"
	depends on INPUT_STMVL53L1
	default n
	help
	  Say Y here if you wish to include support for WL2864C PMIC driver.
```

## drivers/input/touchscreen/chipone_tddi_mmi/Kconfig
```kconfig
config TOUCHSCREEN_CHIPONE_TDDI
	tristate "CHIPONE TDDI Touchscreen"
	default n
	help
	  Say Y here if you have a Chipone flash touchscreen connected
	  to your system by SPI bus.

	  If unsure, say N.

config CHIPONE_ESD
	bool "ESD Detection"
	depends on TOUCHSCREEN_CHIPONE_TDDI
	default n
	help
	  Say Y here if you want to have ESD Detection support.

	  If unsure, say N.
```

## drivers/input/touchscreen/focaltech_0flash_mmi/Kconfig
```kconfig
#
# Focaltech Touchscreen driver configuration
#

config INPUT_TOUCHSCREEN_FOCALTECH_0FLASH_MMI
	tristate "Moto Focaltech Touchscreen"
	depends on I2C
	default n
	help
	  Say Y here if you have Moto Focaltech touch panel.
	  If unsure, say N.

config INPUT_FOCALTECH_0FLASH_MMI_IC_NAME_FT8719
	bool "Focaltech Chip FT8719"
	depends on INPUT_TOUCHSCREEN_FOCALTECH_0FLASH_MMI
	default n
	help
	  Say Y here to enable support for Focaltech FT8719 touch panel.
	  If unsure, say N.

config INPUT_FOCALTECH_0FLASH_MMI_IC_NAME_FT8756
	bool "Focaltech Chip FT8756"
	depends on INPUT_TOUCHSCREEN_FOCALTECH_0FLASH_MMI
	default n
	help
	  Say Y here to enable support for Focaltech FT8756 touch panel.
	  If unsure, say N.

config INPUT_FOCALTECH_0FLASH_MMI_IC_NAME_FT8006S_AA
	bool "Focaltech Chip FT8006"
	depends on INPUT_TOUCHSCREEN_FOCALTECH_0FLASH_MMI
	default n
	help
	  Say Y here to enable support for Focaltech FT8006 touch panel.
	  If unsure, say N.

config INPUT_FOCALTECH_0FLASH_MMI_IC_NAME_FT8009
	bool "Focaltech Chip FT8009"
	depends on INPUT_TOUCHSCREEN_FOCALTECH_0FLASH_MMI
	default n
	help
	  Say Y here to enable support for Focaltech FT8009 touch panel.
	  If unsure, say N.

config INPUT_TOUCHSCREEN_FOCALTECH_0FLASH_MMI_ENABLE_DOUBLE_TAP
	bool "Moto Focaltech Double tap"
	depends on INPUT_TOUCHSCREEN_FOCALTECH_0FLASH_MMI
	default n
	help
	  Say Y here to enable support for double tap functionality on Focaltech touch panel.
	  If unsure, say N.

config INPUT_TOUCHSCREEN_FOCALTECH_0FLASH_MMI_ENABLE_PALM
	bool "Moto Focaltech Palm"
	depends on INPUT_TOUCHSCREEN_FOCALTECH_0FLASH_MMI
	default n
	help
	  Say Y here to enable support for Palm functionality on Focaltech touch panel.
	  If unsure, say N.

config INPUT_TOUCHSCREEN_FOCALTECH_0FLASH_MMI_PANEL_NOTIFICATIONS
	bool "Moto Focaltech Panel notifications"
	depends on INPUT_TOUCHSCREEN_FOCALTECH_0FLASH_MMI
	default n
	help
	  Say Y here to enable support for Panel notifications functionality on Focaltech touch panel.
	  If unsure, say N.

config INPUT_TOUCHSCREEN_FOCALTECH_0FLASH_MMI_PEN_NOTIFIER
	bool "Moto Focaltech Pen"
	depends on INPUT_TOUCHSCREEN_FOCALTECH_0FLASH_MMI
	default n
	help
	  Say Y here to enable support for Pen functionality on Focaltech touch panel.
	  If unsure, say N.
```

## drivers/input/touchscreen/focaltech_0flash_v2_mmi/Kconfig
```kconfig
#
# Focaltech Touchscreen driver configuration
#

config INPUT_TOUCHSCREEN_FOCALTECH_0FLASH_V2_MMI
    tristate "FocalTech Touchscreen Driver 0flash V2 MMI"
    default n
    help
      Say Y here if you wish to include support for FocalTech Touchscreen 0flash V2 MMI.

      If unsure, say N.

      To compile this driver as a module, choose M here: the
      module will be called focaltech_0flash_v2_mmi.

if INPUT_TOUCHSCREEN_FOCALTECH_0FLASH_V2_MMI

config INPUT_TOUCHSCREEN_FOCALTECH_0FLASH_V2_MMI_ENABLE_DOUBLE_TAP
    bool "FocalTech 0flash V2 MMI Double tap"
    depends on SENSORS_CLASS
    default n
    help
      Say Y here if you want to have Double tap support on Moto FocalTech 0flash V2.

      If unsure, say N.

config INPUT_TOUCHSCREEN_FOCALTECH_0FLASH_V2_MMI_NOTIFY_TOUCH_STATE
    bool "FocalTech 0flash V2 MMI Notify touch state"
    default n
    help
      Say Y here if you want to have Notify touch state support on Moto FocalTech 0flash V2.

      If unsure, say N.

config INPUT_TOUCHSCREEN_FOCALTECH_0FLASH_V2_MMI_ESD_EN
    bool "FocalTech 0flash V2 MMI ESD"
    default n
    help
      Say Y here if you want to have ESD support on Moto FocalTech 0flash V2.

      If unsure, say N.

config INPUT_TOUCHSCREEN_FOCALTECH_0FLASH_V2_MMI_PANEL_NOTIFICATIONS
    bool "FocalTech 0flash V2 MMI Panel notifications"
    default n
    help
      Say Y here if you want to have panel notifications support on Moto FocalTech 0flash V2.

      If unsure, say N.

config INPUT_TOUCHSCREEN_FOCALTECH_0FLASH_V2_MMI_DEBUG_EN
    bool "FocalTech 0flash V2 MMI Debug"
    default n
    help
      Say Y here if you want to have debug support on Moto FocalTech 0flash V2.

      If unsure, say N.

config INPUT_TOUCHSCREEN_FOCALTECH_0FLASH_V2_MMI_IC_NAME
    string "FocalTech 0flash V2 MMI IC Name"
    default "ft8726"
    help
      Provide the IC name of the FocalTech 0flash V2 MMI device.

config INPUT_TOUCHSCREEN_FOCALTECH_0FLASH_V2_MMI_PINCTRL_EN
    bool "FocalTech 0flash V2 MMI Pinctrl"
    default n
    help
      Say Y here if you want to have pinctrl support on Moto FocalTech 0flash V2.

      If unsure, say N.

config INPUT_TOUCHSCREEN_FOCALTECH_0FLASH_V2_MMI_LAST_TIME
    bool "FocalTech 0flash V2 MMI Timestamp"
    default n
    help
      Say Y here if you want to have timestamp support on Moto FocalTech 0flash V2.

      If unsure, say N.

endif
```

## drivers/input/touchscreen/focaltech_touch_v3/Kconfig
```kconfig
#
# Focaltech Touchscreen driver configuration
#

config TOUCHSCREEN_FTS_V3
    bool "Focaltech Touchscreen v3"
    default n
    help
      Say Y here if you have Focaltech touch panel.
      If unsure, say N.

config TOUCHSCREEN_FTS_DIRECTORY_V3
    string "Focaltech ts v3 directory name"
    default "focaltech_touch_v3"
    depends on TOUCHSCREEN_FTS_V3

config INPUT_TOUCHSCREEN_FOCALTECH_V3
    tristate "FocalTech Touchscreen Driver V3"
    depends on INPUT_TOUCHSCREEN_MMI
    default n
    help
      Say Y here if you wish to include support for FocalTech Touchscreen V3.

      If unsure, say N.

      To compile this driver as a module, choose M here: the
      module will be called focaltech_v3.

if INPUT_TOUCHSCREEN_FOCALTECH_V3

config INPUT_TOUCHSCREEN_FOCALTECH_V3_MMI_NOISE_TEST_P2P
    bool "FocalTech V3 MMI Noise test point to point"
    default n
    help
      Say Y here if you want to have Noise test point to point support on Moto
      FocalTech V3.

      If unsure, say N.

config INPUT_TOUCHSCREEN_FOCALTECH_V3_MMI_COMPATIBLE_WITH_GKI
    bool "FocalTech V3 MMI GKI compatibility"
    default n
    help
      Say Y here if you want to have GKI compatibility support on Moto
      FocalTech V3.

      If unsure, say N.

config INPUT_TOUCHSCREEN_FOCALTECH_V3_MMI_DOUBLE_TAP_CONTROL
    bool "FocalTech V3 MMI Double tap control"
    default n
    help
      Say Y here if you want to have Double tap control support on Moto
      FocalTech V3.

      If unsure, say N.

config INPUT_TOUCHSCREEN_FOCALTECH_V3_MMI_SUPPORT_HIGH_RESOLUTION
    bool "FocalTech V3 MMI High resolution"
    default n
    help
      Say Y here if you want to have High resolution support on Moto
      FocalTech V3.

      If unsure, say N.

config INPUT_TOUCHSCREEN_FOCALTECH_V3_MMI_VDD_GPIO_CONTROL
    bool "FocalTech V3 MMI VDD GPIO control"
    default n
    help
      Say Y here if you want to have VDD GPIO control support on Moto
      FocalTech V3.

      If unsure, say N.

config INPUT_TOUCHSCREEN_FOCALTECH_V3_MMI_LAST_TIME
    bool "FocalTech V3 MMI Timestamp"
    default n
    help
      Say Y here if you want to have Timestamp support on Moto FocalTech V3.

      If unsure, say N.

config INPUT_TOUCHSCREEN_FOCALTECH_V3_MMI_ENABLE_DOUBLE_TAP
    bool "FocalTech V3 MMI Double tap"
    default n
    help
      Say Y here if you want to have Double tap support on Moto FocalTech V3.

      If unsure, say N.

config INPUT_TOUCHSCREEN_FOCALTECH_V3_MMI_ENABLE_PALM
    bool "FocalTech V3 MMI Palm Sensor"
    default n
    help
      Say Y here if you want to have palm sensor support on Moto FocalTech V3.

      If unsure, say N.

endif
```
