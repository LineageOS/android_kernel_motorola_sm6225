## drivers/input/touchscreen/focaltech_v2_mmi/Kconfig
```kconfig
#
# Focaltech Touchscreen driver configuration
#

config TOUCHSCREEN_FTS
    bool "Focaltech Touchscreen"
    depends on I2C
    default n
    help
      Say Y here if you have Focaltech touch panel.
      If unsure, say N.

config TOUCHSCREEN_FTS_DIRECTORY
    string "Focaltech ts directory name"
    default "focaltech_touch"
    depends on TOUCHSCREEN_FTS

config INPUT_TOUCHSCREEN_FOCALTECH_V2_MMI
    tristate "FocalTech Touchscreen Driver V2 MMI"
    depends on INPUT_TOUCHSCREEN_MMI
    default n
    help
      Say Y here if you wish to include support for FocalTech Touchscreen V2 MMI.

      If unsure, say N.

      To compile this driver as a module, choose M here: the
      module will be called focaltech_v2_mmi.


if INPUT_TOUCHSCREEN_FOCALTECH_V2_MMI

config INPUT_TOUCHSCREEN_FOCALTECH_V2_MMI_IC_NAME
    string "FocalTech V2 MMI IC Name"
    depends on INPUT_TOUCHSCREEN_FOCALTECH_V2_MMI
    default "ft3518u"
    help
      Provide the IC name of the FocalTech V2 MMI device.

config INPUT_TOUCHSCREEN_FOCALTECH_V2_MMI_ENABLE_DOUBLE_TAP
    bool "FocalTech V2 MMI Double tap"
    depends on INPUT_TOUCHSCREEN_FOCALTECH_V2_MMI
    default n
    help
      Say Y here if you want to have Double tap support on Moto FocalTech V2.

      If unsure, say N.

config INPUT_TOUCHSCREEN_FOCALTECH_V2_MMI_ENABLE_PALM
    bool "FocalTech V2 MMI Palm Sensor"
    depends on INPUT_TOUCHSCREEN_FOCALTECH_V2_MMI
    default n
    help
      Say Y here if you want to have palm sensor support on Moto FocalTech V2.

      If unsure, say N.

config INPUT_TOUCHSCREEN_FOCALTECH_V2_MMI_PEN_NOTIFIER
    bool "FocalTech V2 MMI Pen notifier"
    depends on INPUT_TOUCHSCREEN_FOCALTECH_V2_MMI
    default n
    help
      Say Y here if you want to have pen notifier support on Moto FocalTech V2.

      If unsure, say N.


endif
```

## drivers/input/touchscreen/goodix_berlin_mmi/Kconfig
```kconfig
#
# Goodix touchscreen driver configuration
#
menuconfig TOUCHSCREEN_GOODIX_BRL
	tristate "Goodix berlin touchscreen"
	help
	  Say Y here if you have a Goodix berlin series touch controller
	  to your system.

	  If build module, say M.
	  If unsure, say N.

if TOUCHSCREEN_GOODIX_BRL

config TOUCHSCREEN_GOODIX_BRL_SPI
	bool "Goodix berlin SPI bus connection"
	help
	  Say Y here if the touchscreen is connected via SPI bus.

config GTP_FOD
	bool "Goodix berlin FOD"
	help
	  Say Y here to support FOD.

config GTP_LIMIT_USE_SUPPLIER
	bool "Goodix berlin limit use supplier"
	default n
	help
	  Say Y here if you want to limit use supplier on Goodix berlin.

	  If unsure, say N.

config GTP_ENABLE_PM_QOS
	bool "Goodix berlin PM QoS"
	default n
	help
	  Say Y here if you want to enable PM QoS on Goodix berlin.

	  If unsure, say N.

config GOODIX_ESD_ENABLE
	bool "Goodix berlin ESD"
	default n
	help
	  Say Y here if you want to enable ESD on Goodix berlin.

	  If unsure, say N.

config GTP_LAST_TIME
	bool "Goodix berlin timestamp"
	default n
	help
	  Say Y here if you want to enable timestamp on Goodix berlin.

	  If unsure, say N.

config ENABLE_GTP_PALM_CANCEL
	bool "Goodix berlin palm cancel"
	default n
	help
	  Say Y here if you want to enable palm cancel on Goodix berlin.

	  If unsure, say N.

endif
```

## drivers/input/touchscreen/himax_v3_mmi/Kconfig
```kconfig
#
# Himax v3 touchscreen driver configuration
#
config INPUT_HIMAX_V3_MMI
	tristate "HIMAX v3 chipset SPI touchscreen"
	help
	  This enables support for HIMAX v3 CHIPSET over SPI based touchscreens.

config TOUCHSCREEN_HIMAX_V3_MMI_INCELL
	bool "HIMAX chipset in-cell function"
	depends on INPUT_HIMAX_V3_MMI
	help
	  This enables support for HIMAX CHIPSET of in-cell function.

config INPUT_HIMAX_V3_MMI_IC_HX83112
	bool "HIMAX v3 chipset HX83112 function"
	depends on INPUT_HIMAX_V3_MMI
	help
	  This enables support for HIMAX v3 CHIPSET of HX83112.

config INPUT_HIMAX_V3_MMI_IC_HX83102
	bool "HIMAX v3 chipset HX83102 function"
	depends on INPUT_HIMAX_V3_MMI
	help
	  This enables support for HIMAX v3 CHIPSET of HX83102.

config INPUT_HIMAX_V3_MMI_IC_HX83102D
	bool "HIMAX v3 chipset HX83102D function"
	depends on INPUT_HIMAX_V3_MMI
	help
	  This enables support for HIMAX v3 CHIPSET of HX83102D.

config TOUCHSCREEN_HIMAX_V3_MMI_DEBUG
	bool "HIMAX debug function"
	depends on INPUT_HIMAX_V3_MMI
	help
	  This enables support for HIMAX debug function.

config TOUCHSCREEN_HIMAX_V3_MMI_INSPECT
	bool "HIMAX inspect function"
	depends on INPUT_HIMAX_V3_MMI
	help
	  This enables support for HIMAX debug function.

config TOUCHSCREEN_HIMAX_V3_MMI_ENABLE_PALM
	bool "HIMAX palm sensor function"
	depends on INPUT_HIMAX_V3_MMI
	help
	  This enables support for HIMAX v3 palm sensor function.

config TOUCHSCREEN_HIMAX_V3_MMI_ENABLE_DOUBLE_TAP
	bool "HIMAX double tap function"
	depends on INPUT_HIMAX_V3_MMI
	help
	  This enables support for HIMAX v3 double tap function.

config TOUCHSCREEN_HIMAX_V3_MMI_ENABLE_MULTI_BIN
	bool "HIMAX multi bin function"
	depends on INPUT_HIMAX_V3_MMI
	help
	  This enables support for HIMAX v3 multi bin function.

config INPUT_TOUCHSCREEN_HIMAX_V3_MMI_0FLASH
	bool "HIMAX platform QCT SPI function"
	depends on INPUT_HIMAX_V3_MMI
	help
	  This enables support for HIMAX platform QCT SPI function.
```

## drivers/input/touchscreen/ili9882_mmi/Kconfig
```kconfig
config INPUT_TOUCHSCREEN_ILI_9882_MMI
    tristate "Ilitek Touchscreen Driver 9882 MMI"
    default n
    help
      Say Y here if you wish to include support for Ilitek Touchscreen Driver 9882 MMI.

      If unsure, say N.

      To compile this driver as a module, choose M here: the
      module will be called ili9882_mmi.

if INPUT_TOUCHSCREEN_ILI_9882_MMI

config INPUT_TOUCHSCREEN_ILI_9882_MMI_ENABLE_DOUBLE_TAP
    bool "Ilitek Touchscreen Driver 9882 MMI Double tap"
    depends on SENSORS_CLASS
    default n
    help
      Say Y here if you want to have double tap support on Ilitek 9882 MMI.

      If unsure, say N.

config INPUT_TOUCHSCREEN_ILI_9882_MMI_NOTIFY_TOUCH_STATE
    bool "Ilitek Touchscreen Driver 9882 MMI Touch state"
    default n
    help
      Say Y here if you want to have touch state support on Ilitek 9882 MMI.

      If unsure, say N.

config INPUT_TOUCHSCREEN_ILI_9882_MMI_PANEL_NOTIFICATIONS
    bool "Ilitek Touchscreen Driver 9882 MMI Panel notifications"
    default n
    help
      Say Y here if you want to have panel notifications support on Ilitek 9882 MMI.

      If unsure, say N.

config INPUT_TOUCHSCREEN_ILI_9882_MMI_RESUME_BY_DDI
    bool "Ilitek Touchscreen Driver 9882 MMI Resume by DDI"
    default n
    help
      Say Y here if you want to have resume by DDI support on Ilitek 9882 MMI.

      If unsure, say N.

config INPUT_TOUCHSCREEN_ILI_9882_MMI_FW_PANEL
    bool "Ilitek Touchscreen Driver 9882 MMI FW panel"
    default n
    help
      Say Y here if you want to have FW panel support on Ilitek 9882 MMI.

      If unsure, say N.

config INPUT_TOUCHSCREEN_ILI_9882_MMI_SUSPEND_PWROFF
    bool "Ilitek Touchscreen Driver 9882 MMI Suspend power-off"
    default n
    help
      Say Y here if you want to have suspend power-off support on Ilitek 9882 MMI.

      If unsure, say N.

config INPUT_TOUCHSCREEN_ILI_9882_MMI_CHARGER
    bool "Ilitek Touchscreen Driver 9882 MMI Charger"
    default n
    help
      Say Y here if you want to have charger support on Ilitek 9882 MMI.

      If unsure, say N.

config INPUT_TOUCHSCREEN_ILI_9882_MMI_ESD
    bool "Ilitek Touchscreen Driver 9882 MMI ESD"
    default n
    help
      Say Y here if you want to have ESD support on Ilitek 9882 MMI.

      If unsure, say N.

config INPUT_TOUCHSCREEN_ILI_9882_MMI_PEN_NOTIFIER
    bool "Ilitek Touchscreen Driver 9882 MMI Pen notifier"
    default n
    help
      Say Y here if you want to have pen notifier support on Ilitek 9882 MMI.

      If unsure, say N.

config INPUT_TOUCHSCREEN_ILI_9882_MMI_GESTURE
    bool "Ilitek Touchscreen Driver 9882 MMI Gesture"
    default n
    help
      Say Y here if you want to have gesture support on Ilitek 9882 MMI.

      If unsure, say N.

config INPUT_TOUCHSCREEN_ILI_9882_MMI_PANEL_GESTURE
    bool "Ilitek Touchscreen Driver 9882 MMI Panel gesture"
    default n
    help
      Say Y here if you want to have panel gesture support on Ilitek 9882 MMI.

      If unsure, say N.

config INPUT_TOUCHSCREEN_ILI_9882_MMI_PASSIVE_PEN
    bool "Ilitek Touchscreen Driver 9882 MMI Passive pen"
    default n
    help
      Say Y here if you want to have passive pen support on Ilitek 9882 MMI.

      If unsure, say N.

config INPUT_TOUCHSCREEN_ILI_9882_MMI_LAST_TIME
    bool "Ilitek Touchscreen Driver 9882 MMI Timestamp"
    default n
    help
      Say Y here if you want to have timestamp support on Ilitek 9882 MMI.

      If unsure, say N.

endif
```

## drivers/input/touchscreen/ilitek_0flash_mmi/Kconfig
```kconfig
config INPUT_TOUCHSCREEN_ILI_0FLASH_MMI
    tristate "Ilitek Touchscreen Driver 0flash MMI"
    default n
    help
      Say Y here if you wish to include support for Ilitek Touchscreen Driver 0flash MMI.

      If unsure, say N.

      To compile this driver as a module, choose M here: the
      module will be called ilitek_0flash_mmi.

if INPUT_TOUCHSCREEN_ILI_0FLASH_MMI

config INPUT_TOUCHSCREEN_ILI_0FLASH_MMI_ENABLE_DOUBLE_TAP
    bool "Ilitek Touchscreen Driver 0flash MMI Double tap"
    depends on SENSORS_CLASS
    default n
    help
      Say Y here if you want to have double tap support on Ilitek 0flash MMI.

      If unsure, say N.

config INPUT_TOUCHSCREEN_ILI_0FLASH_MMI_PANEL_NOTIFICATIONS
    bool "Ilitek Touchscreen Driver 0flash MMI Panel notifications"
    default n
    help
      Say Y here if you want to have panel notifications support on Ilitek 0flash MMI.

      If unsure, say N.

config INPUT_TOUCHSCREEN_ILI_0FLASH_MMI_RESUME_BY_DDI
    bool "Ilitek Touchscreen Driver 0flash MMI Resume by DDI"
    default n
    help
      Say Y here if you want to have resume by DDI support on Ilitek 0flash MMI.

      If unsure, say N.

endif
```

## drivers/input/touchscreen/ilitek_tddi_mmi/Kconfig
```kconfig
#
# Ilitek_9882 Touchscreen driver configuration
#

config TOUCHSCREEN_ILITEK_CHIPSET
	tristate "ILITEK Touchscreen"
	default n
	help
	  Say Y here if you have a Moto Novatek NT36xxx no flash touchscreen connected
	  to your system by SPI bus.

	  If unsure, say N.

config INPUT_ILI_0FLASH_MMI_ENABLE_DOUBLE_TAP
	bool "ILITEK Double Tap"
	depends on TOUCHSCREEN_ILITEK_CHIPSET
	default n
	help
	  Say Y here if you want to have Double tap support.

	  If unsure, say N.

config INPUT_ILI_PANEL_NOTIFICATIONS
	bool "ILITEK Panel Notification"
	depends on TOUCHSCREEN_ILITEK_CHIPSET
	default n
	help
	  Say Y here if you want to have panel notification support.

	  If unsure, say N.

config ILITEK_RESUME_BY_DDI
        bool "ILITEK Resume by Display Driver Integration"
        depends on TOUCHSCREEN_ILITEK_CHIPSET
        default n
        help
          Say Y here if you want to have panel notification support.

          If unsure, say N.

config ILITEK_FW_PANEL
        bool "ILITEK Firmware Panel"
        depends on TOUCHSCREEN_ILITEK_CHIPSET
        default n
        help
          Say Y here if you want to have panel notification support.

          If unsure, say N.

config ILITEK_ESD
        bool "ILITEK Electrostatic Discharge Protection"
        depends on TOUCHSCREEN_ILITEK_CHIPSET
        default n
        help
          Say Y here if you want to have panel notification support.

          If unsure, say N.

config ILITEK_GESTURE
        bool "ILITEK Gesture"
        depends on TOUCHSCREEN_ILITEK_CHIPSET
        default n
        help
          Say Y here if you want to have panel notification support.

          If unsure, say N.

config ILITEK_PANEL_GESTURE
        bool "ILITEK Panel Gesture"
        depends on TOUCHSCREEN_ILITEK_CHIPSET
        default n
        help
          Say Y here if you want to have panel notification support.

          If unsure, say N.
```
