/* Copyright (c) 2015, 2018, The Linux Foundation. All rights reserved.
 *
 * This program is free software; you can redistribute it and/or modify
 * it under the terms of the GNU General Public License version 2 and
 * only version 2 as published by the Free Software Foundation.
 *
 * This program is distributed in the hope that it will be useful,
 * but WITHOUT ANY WARRANTY; without even the implied warranty of
 * MERCHANTABILITY or FITNESS FOR A PARTICULAR PURPOSE.  See the
 * GNU General Public License for more details.
 */

/*---------------------------------------------------------------------------
 * This file is autogenerated file using gcdb parser. Please do not edit it.
 * Update input XML file to add a new entry or update variable in this file
 * VERSION = "1.0"
 *---------------------------------------------------------------------------
 */

&mdss_mdp {
	dsi_tm_icnl9911c_video:qcom,mdss_dsi_icnl9911c_tm_video {
		qcom,mdss-dsi-panel-name ="mipi_mot_vid_tm_incl9911c_720p_652";
		qcom,mdss-dsi-panel-type = "dsi_video_mode";
		qcom,mdss-dsi-panel-supplier = "tianma";

		qcom,dsi-ctrl-num = <0>;
		qcom,dsi-phy-num = <0>;

		qcom,mdss-dsi-virtual-channel-id = <0>;
		qcom,mdss-dsi-stream = <0>;
		qcom,mdss-dsi-h-left-border = <0>;
		qcom,mdss-dsi-h-right-border = <0>;
		qcom,mdss-dsi-v-top-border = <0>;
		qcom,mdss-dsi-v-bottom-border = <0>;
		qcom,mdss-dsi-bpp = <24>;
		qcom,mdss-dsi-color-order = "rgb_swap_rgb";
		qcom,mdss-dsi-underflow-color = <0xff>;
		qcom,mdss-dsi-border-color = <0>;
		qcom,mdss-dsi-h-sync-pulse = <0>;
		qcom,mdss-dsi-traffic-mode = "burst_mode";
		qcom,mdss-dsi-lane-map = "lane_map_0123";
		qcom,mdss-dsi-bllp-eof-power-mode;
		qcom,mdss-dsi-bllp-power-mode;
		qcom,mdss-dsi-tx-eot-append;
		qcom,mdss-dsi-lane-0-state;
		qcom,mdss-dsi-lane-1-state;
		qcom,mdss-dsi-lane-2-state;
		qcom,mdss-dsi-lane-3-state;
		qcom,mdss-dsi-dma-trigger = "trigger_sw";
		qcom,mdss-dsi-mdp-trigger = "none";
		qcom,mdss-dsi-lp11-init;
		qcom,mdss-dsi-reset-sequence = <1 10>, <0 10>, <1 50>;
		qcom,mdss-pan-physical-width-dimension = <68>;
		qcom,mdss-pan-physical-height-dimension = <151>;

		qcom,mdss-dsi-bl-pmic-control-type = "bl_ctrl_dcs";
		qcom,mdss-dsi-bl-min-level = <1>;
		qcom,mdss-dsi-bl-max-level = <4095>;
		qcom,mdss-dsi-bl-default-level = <127>;

		qcom,mdss-dsi-cabc-ui-command = [15 01 00 00 00 00 02 55 01
						39 01 00 00 00 00 03 F0 5A 59
						39 01 00 00 00 00 03 F1 A5 A6
						39 01 00 00 00 00 18 E1 EF FE FE FE FE EE F0 20 33 FF 00 00 6A 90 C0 0D 6A F0 3E FF 00 06 40
						39 01 00 00 00 00 1B E0 30 00 80 88 11 3F 22 62 DF A0 04 CC 01 FF F6 FF F0 FD FF FD F8 F5 FC FC FD FF
						39 01 00 00 00 00 03 F1 5A 59
						39 01 00 00 00 00 03 F0 A5 A6];
		qcom,mdss-dsi-cabc-ui-command-state = "dsi_hs_mode";
		qcom,mdss-dsi-cabc-mv-command = [15 01 00 00 00 00 02 55 03
						39 01 00 00 00 00 03 F0 5A 59
						39 01 00 00 00 00 03 F1 A5 A6
						39 01 00 00 00 00 18 E1 BC F8 CC FA DB 9B F0 E7 F0 85 F0 70 00 50 00 9A FD F0 E0 FF 00 06 40
						39 01 00 00 00 00 1B E0 30 00 80 88 11 3F 22 62 DF A0 04 CC 01 FF FA FF F0 FD FF FB F8 F5 FC FC FB FF
						39 01 00 00 00 00 03 F1 5A 59
						39 01 00 00 00 00 03 F0 A5 A6];
		qcom,mdss-dsi-cabc-mv-command-state = "dsi_hs_mode";
		qcom,mdss-dsi-cabc-dis-command = [15 01 00 00 00 00 02 55 00];
		qcom,mdss-dsi-cabc-dis-command-state = "dsi_hs_mode";
		qcom,mdss-dsi-hbm-on-command = [39 01 00 00 00 00 03 51 0F FF];
		qcom,mdss-dsi-hbm-on-command-state = "dsi_hs_mode";
		qcom,mdss-dsi-hbm-off-command = [39 01 00 00 00 00 03 51 0C CC];
		qcom,mdss-dsi-hbm-off-command-state = "dsi_hs_mode";

		qcom,mdss-dsi-display-timings {
			timing@0{
				qcom,mdss-dsi-panel-width = <720>;
				qcom,mdss-dsi-panel-height = <1600>;
				qcom,mdss-dsi-h-front-porch = <50>;
				qcom,mdss-dsi-h-back-porch = <50>;
				qcom,mdss-dsi-h-pulse-width = <4>;
				qcom,mdss-dsi-h-sync-skew = <0>;
				qcom,mdss-dsi-v-back-porch = <12>;
				qcom,mdss-dsi-v-front-porch = <32>;
				qcom,mdss-dsi-v-pulse-width = <4>;
				qcom,mdss-dsi-panel-framerate = <60>;
				qcom,mdss-dsi-on-command = [
					39 01 00 00 00 00 03 F0 5A 59
					39 01 00 00 00 00 03 F1 A5 A6
					39 01 00 00 00 00 1f B0 82 81 05 04 87 86 84 85 66 66 33 33 20 01 01 78 01 01 0F 05 04 03 02 01 02 03 04 00 00 00
					39 01 00 00 00 00 1e B1 11 42 86 00 01 01 01 66 01 01 04 08 54 00 00 00 44 40 02 01 40 02 01 40 02 01 40 02 01
					39 01 00 00 00 00 12 B2 54 C4 82 05 40 02 01 40 02 01 05 05 54 0C 0C 0D 0B
					39 01 00 00 00 00 20 B3 02 00 00 00 00 26 26 91 A2 33 44 00 26 00 18 01 02 08 20 30 08 09 44 20 40 20 40 08 09 22 33
					39 01 00 00 00 00 1d B4 0A 02 DC 1D 00 02 02 02 02 12 10 02 02 0E 0C 04 03 03 03 03 03 03 FF FF FC 00 00 00
					39 01 00 00 00 00 1d B5 0B 02 DC 1D 00 02 02 02 02 13 11 02 02 0F 0D 05 03 03 03 03 03 03 FF FF FC 00 00 00
					39 01 00 00 00 00 19 B8 00 00 00 00 00 00 00 00 00 00 00 00 00 00 00 00 00 00 00 00 00 00 00 00
					39 01 00 00 00 00 0e BB 01 05 09 11 0D 19 1D 55 25 69 00 21 25
					39 01 00 00 00 00 0f BC 00 00 00 00 02 20 FF 00 03 33 01 73 33 00
					39 01 00 00 00 00 0b BD E9 02 4F CF 72 A4 08 44 AE 15
					39 01 00 00 00 00 0b BE 73 73 50 46 0C 77 43 07 0E 0E
					39 01 00 00 00 00 09 BF 07 25 07 25 7F 00 11 04
					39 01 00 00 00 00 0a C0 10 FF FF FF FF FF 00 FF 00
					39 01 00 00 00 00 14 C1 C0 0C 20 7C 04 28 28 04 2A 40 36 00 07 CF FF FF A1 01 C0
					15 01 00 00 00 00 02 C2 00
					39 01 00 00 00 00 0a C3 06 00 FF 00 FF 00 00 81 01
					39 01 00 00 00 00 0c C5 02 1C C0 C0 40 90 54 04 08 09 14
					39 01 00 00 00 00 0b C6 86 15 22 2E 2E B3 00 34 08 04
					39 01 00 00 00 00 17 C7 FC B7 8F 73 45 25 F6 4C 1C F6 CF A3 FC D0 B2 88 70 4D 1A 7E C0 00
					39 01 00 00 00 00 17 C8 FC B7 8F 73 45 25 F6 4C 1C F6 CF A3 FC D0 B2 88 70 4D 1A 7E C0 00
					15 01 00 00 00 00 02 CB 00
					39 01 00 00 00 00 06 D0 80 0D FF 0F 61
					15 01 00 00 00 00 02 D2 42
					39 01 00 00 00 00 18 E1 EF FE FE FE FE EE F0 20 33 FF 00 00 6A 90 C0 0D 6A F0 3E FF 00 06 40
					39 01 00 00 00 00 1B E0 30 00 80 88 11 3F 22 62 DF A0 04 CC 01 FF F6 FF F0 FD FF FD F8 F5 FC FC FD FF
					39 01 00 00 00 00 03 F1 5A 59
					39 01 00 00 00 00 03 F0 A5 A6
					15 01 00 00 00 00 02 35 00
					39 01 00 00 00 00 03 51 00 00
					15 01 00 00 00 00 02 53 2c
					15 01 00 00 00 00 02 55 01
					05 01 00 00 78 00 02 11 00
					05 01 00 00 64 00 02 29 00];
				qcom,mdss-dsi-off-command = [
					15 01 00 00 14 00 02 28 00
					15 01 00 00 78 00 02 10 00];
				qcom,mdss-dsi-on-command-state = "dsi_lp_mode";
				qcom,mdss-dsi-off-command-state = "dsi_lp_mode";
                        };
                };
	};
};

