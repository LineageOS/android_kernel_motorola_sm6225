/* Copyright (c) 2020, The Linux Foundation. All rights reserved.
 *
 * This program is free software; you can redistribute it and/or modify
 * it under the terms of the GNU General Public License version 2 and
 * only version 2 as published by the Free Software Foundation.
 *
 * This program is distributed in the hope that it will be useful,
 * but WITHOUT ANY WARRANTY; without even the implied warranty of
 * MERCHANTABILITY or FITNESS FOR A PARTICULAR PURPOSE.  See the
 * GNU General Public License for more details.
 */

/dts-v1/;
/plugin/;

#include "bengal-capri-common-overlay.dtsi"
#include "bengal-capri-charge-6000-overlay.dtsi"
#include "bengal-capri-hbm-display.dtsi"

/ {
	model = "capri";
	compatible = "qcom,bengal-capri", "qcom,bengal-moto", "qcom,bengal";
	qcom,msm-id = <417 0x10000>;
	qcom,board-id = <(5<<8) 0xB200>;
};

/*
 * capri HW rev specific changes go here
 */
