/* Copyright (c) 2020, The Linux Foundation. All rights reserved.
 *
 * This program is free software; you can redistribute it and/or modify
 * it under the terms of the GNU General Public License version 2 and
 * only version 2 as published by the Free Software Foundation.
 *
 * This program is distributed in the hope that it will be useful,
 * but WITHOUT ANY WARRANTY; without even the implied warranty of
 * MERCHANTABILITY or FITNESS FOR A PARTICULAR PURPOSE.  See the
 * GNU General Public License for more details.
 */

&qupv3_se1_i2c {
 status = "ok";
    aw99703-bl@36 {
        compatible = "awinic,aw99703-bl";
        reg = <0x36>;
        aw99703,hwen-gpio = <&pmi632_gpios 6 0>;
        aw99703,pwm-mode = <1>; /*0 pwm disable,1 PWM enable*/
        aw99703,using-lsb;
        aw99703,bl-fscal-led = <0x1B>;/*default 25mA*/
        aw99703,turn-on-ramp = <0x09>;
        aw99703,turn-off-ramp = <0x09>;
        aw99703,pwm-trans-dim = <0>;
        aw99703,i2c-trans-dim = <0x07>;
        aw99703,bl-channel = <2>;
        aw99703,bl-map = <3>; /*brightness map level 1:256,2:1024,3:2048*/
    };
};
