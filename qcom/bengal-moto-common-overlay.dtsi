#include <dt-bindings/gpio/gpio.h>
#include <dt-bindings/input/input.h>

&utags {
       compatible = "mmi,utags";
       mmi,main-utags = "/dev/block/bootdevice/by-name/utags";
       mmi,backup-utags = "/dev/block/bootdevice/by-name/utagsBackup";
};

&hw {
       compatible = "mmi,utags";
       mmi,dir-name = "hw";
       mmi,main-utags = "/dev/block/bootdevice/by-name/hw";
};

&pmi632_charger {
        qcom,dr-supported;
        qcom,auto-recharge-soc = <99>;
        qcom,flash-disable-soc = <1>;
};
