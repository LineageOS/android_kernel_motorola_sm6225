/*
 * Copyright (C) 2021 Motorola Inc.
 *
 * This program is free software; you can redistribute it and/or modify
 * it under the terms of the GNU General Public License version 2 as
 * published by the Free Software Foundation.
 *
 * This program is distributed in the hope that it will be useful,
 * but WITHOUT ANY WARRANTY; without even the implied warranty of
 * MERCHANTABILITY or FITNESS FOR A PARTICULAR PURPOSE.
 * See http://www.gnu.org/licenses/gpl-2.0.html for more details.
 */
md50-scud-5000mah {
        serialnum = "SB18D01192";
	/* add for aging cv */
	rt,fcc = <4815 4815 4815 4815 4815>;
	rt,fg_fc_vth = <0x9e 0x9e 0x9e 0x9e 0x9e>;
	rt,fg_extreg_table = [80 80 33 6E B7 E4 58 02 CF 98 61 3A 88 81 00 00
				80 34 00 00 FB 3E 00 20 FF 08 1D 32 12 05 5A 5A
				00 82 00 02 00 02 00 40 00 40 CF 12 CF 12 04 24
				64 00 5F 0B 64 00 5F 0B FF 00 00 14 00 00 14 B7
				15 0E 48 44 9E 4C 05 41 19 05 8E 12 23 32 1A 00
				13 88 24 82 77 AD 04 73 12 A3 52 68 57 64 25 0F
				20 16 03 08 08 08 03 03 03 02 03 03 03 00 00 FC
				F9 F2 F2 F2 F0 F0 D7 CA F2 F2 F2 CE CE 9C 81 00
				76 02 C0 48 14 09 00 00 00 00 00 00 00 00 37 73
				2D 19 05 FB 00 00 B9 36 96 33 0F 07 00 00 0B A9
				32 32 88 88 32 32 88 88 32 32 88 88 32 32 88 88
				32 32 88 88 32 32 88 88 32 32 88 88 32 32 88 88
				32 32 88 88 32 32 88 88 32 32 88 88 32 32 88 88
				32 32 88 88 32 32 88 88 32 32 88 88 32 32 88 88 ];
	rt,fg_ocv_table0 = <0x0013 0x4A40 0x5000 0x5796 0x5B50 0x5BE3 0x5CD7 0x5E10
			   0x5FC6 0x60DB 0x619C 0x6292 0x6381 0x6643 0x688B 0x69E8
			   0x6B12 0x6BE2 0x6D20 0x706D 0x1700 0x0796 0x02DE 0x009C
			   0x003E 0x0041 0x0036 0x0041 0x0048 0x0085 0x0088 0x008C
			   0x008E 0x008E 0x008E 0x005C 0x005C 0x0152 0x0013 0xFF80
			   0x0000 0x0200 0x049A 0x0680 0x0E4D 0x17E6 0x281A 0x309A
			   0x3600 0x39B3 0x3D33 0x474D 0x4F80 0x5466 0x589A 0x5D1A
			   0x6400 0x6900 0x000B 0x0022 0x0059 0x01A5 0x041B 0x03EB
			   0x04BD 0x03EE 0x0394 0x01EC 0x01E1 0x01D5 0x01CC 0x01CC
			   0x01CE 0x02C6 0x02C6 0x00C2 0xE7EC 0x0000 0x0000 0x0000 >;
	rt,fg_ocv_table1 = <0x0013 0x4A40 0x5000 0x5796 0x5B50 0x5BE3 0x5CD7 0x5E10
			   0x5FC6 0x60DB 0x619C 0x6292 0x6381 0x6643 0x688B 0x69E8
			   0x6B12 0x6BE2 0x6D20 0x706D 0x1700 0x0796 0x02DE 0x009C
			   0x003E 0x0041 0x0036 0x0041 0x0048 0x0085 0x0088 0x008C
			   0x008E 0x008E 0x008E 0x005C 0x005C 0x0152 0x0013 0xFF80
			   0x0000 0x0200 0x049A 0x0680 0x0E4D 0x17E6 0x281A 0x309A
			   0x3600 0x39B3 0x3D33 0x474D 0x4F80 0x5466 0x589A 0x5D1A
			   0x6400 0x6900 0x000B 0x0022 0x0059 0x01A5 0x041B 0x03EB
			   0x04BD 0x03EE 0x0394 0x01EC 0x01E1 0x01D5 0x01CC 0x01CC
			   0x01CE 0x02C6 0x02C6 0x00C2 0xE7EC 0x0000 0x0000 0x0000 >;
	rt,fg_ocv_table2 = <0x0013 0x4A40 0x5000 0x5796 0x5B50 0x5BE3 0x5CD7 0x5E10
			   0x5FC6 0x60DB 0x619C 0x6292 0x6381 0x6643 0x688B 0x69E8
			   0x6B12 0x6BE2 0x6D20 0x706D 0x1700 0x0796 0x02DE 0x009C
			   0x003E 0x0041 0x0036 0x0041 0x0048 0x0085 0x0088 0x008C
			   0x008E 0x008E 0x008E 0x005C 0x005C 0x0152 0x0013 0xFF80
			   0x0000 0x0200 0x049A 0x0680 0x0E4D 0x17E6 0x281A 0x309A
			   0x3600 0x39B3 0x3D33 0x474D 0x4F80 0x5466 0x589A 0x5D1A
			   0x6400 0x6900 0x000B 0x0022 0x0059 0x01A5 0x041B 0x03EB
			   0x04BD 0x03EE 0x0394 0x01EC 0x01E1 0x01D5 0x01CC 0x01CC
			   0x01CE 0x02C6 0x02C6 0x00C2 0xE7EC 0x0000 0x0000 0x0000 >;
	rt,fg_ocv_table3 = <0x0013 0x4A40 0x5000 0x5796 0x5B50 0x5BE3 0x5CD7 0x5E10
			   0x5FC6 0x60DB 0x619C 0x6292 0x6381 0x6643 0x688B 0x69E8
			   0x6B12 0x6BE2 0x6D20 0x706D 0x1700 0x0796 0x02DE 0x009C
			   0x003E 0x0041 0x0036 0x0041 0x0048 0x0085 0x0088 0x008C
			   0x008E 0x008E 0x008E 0x005C 0x005C 0x0152 0x0013 0xFF80
			   0x0000 0x0200 0x049A 0x0680 0x0E4D 0x17E6 0x281A 0x309A
			   0x3600 0x39B3 0x3D33 0x474D 0x4F80 0x5466 0x589A 0x5D1A
			   0x6400 0x6900 0x000B 0x0022 0x0059 0x01A5 0x041B 0x03EB
			   0x04BD 0x03EE 0x0394 0x01EC 0x01E1 0x01D5 0x01CC 0x01CC
			   0x01CE 0x02C6 0x02C6 0x00C2 0xE7EC 0x0000 0x0000 0x0000 >;
	rt,fg_ocv_table4 = <0x0013 0x4A40 0x5000 0x5796 0x5B50 0x5BE3 0x5CD7 0x5E10
			   0x5FC6 0x60DB 0x619C 0x6292 0x6381 0x6643 0x688B 0x69E8
			   0x6B12 0x6BE2 0x6D20 0x706D 0x1700 0x0796 0x02DE 0x009C
			   0x003E 0x0041 0x0036 0x0041 0x0048 0x0085 0x0088 0x008C
			   0x008E 0x008E 0x008E 0x005C 0x005C 0x0152 0x0013 0xFF80
			   0x0000 0x0200 0x049A 0x0680 0x0E4D 0x17E6 0x281A 0x309A
			   0x3600 0x39B3 0x3D33 0x474D 0x4F80 0x5466 0x589A 0x5D1A
			   0x6400 0x6900 0x000B 0x0022 0x0059 0x01A5 0x041B 0x03EB
			   0x04BD 0x03EE 0x0394 0x01EC 0x01E1 0x01D5 0x01CC 0x01CC
			   0x01CE 0x02C6 0x02C6 0x00C2 0xE7EC 0x0000 0x0000 0x0000 >;
};

