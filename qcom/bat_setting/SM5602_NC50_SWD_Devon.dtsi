/*
 * Copyright (C) 2022 Motorola Inc.
 *
 * This program is free software; you can redistribute it and/or modify
 * it under the terms of the GNU General Public License version 2 as
 * published by the Free Software Foundation.
 *
 * This program is distributed in the hope that it will be useful,
 * but WITHOUT ANY WARRANTY; without even the implied warranty of
 * MERCHANTABILITY or FITNESS FOR A PARTICULAR PURPOSE.
 * See http://www.gnu.org/licenses/gpl-2.0.html for more details.
 */
SM5602_NC50_SWD {
	serialnum = "SB18D38323";

	battery,param_version = <2>;
	battery,max_voltage_uv = <4450000>;
	battery,battery_type = <4450 0x0 0x2600>;
	battery,battery_table0 = <0x1400 0x1C6C 0x1CE7 0x1D42 0x1D64 0x1D84 0x1D91 0x1D9B
					0x1DD6 0x1E0A 0x1E39 0x1E77 0x1ECB 0x1F2B 0x1F59 0x1FE1
					0x200E 0x20E1 0x2195 0x2214 0x226A 0x230B 0x234E 0x2733>;
	battery,battery_table1 = <0x0 0x85 0x193 0x2A0 0x327 0x435 0x650 0xA86 0xEBC 0x13FF
					0x1942 0x2127 0x2BAE 0x3393 0x3635 0x3B78 0x3E1A 0x48A1
					0x5086 0x55C9 0x5979 0x60D7 0x6400 0x64E6>;
	battery,battery_table2 = <0x1C28 0x1618 0x1415 0x1112 0x1010 0x0F0F 0x0E0E 0x0E0E>;
	battery,alpha = <0x00CC>;
	battery,beta = <0x0025>;
	battery,rs = <0x805F>;
	battery,rs_value = <0x0050 0x010A 0x3800 0x0048>;
	battery,vit_period = <0x325A>;
	battery,volt_cal = <0x8000>;
	battery,mix_value = <0x0003>;
	battery,curr_offset = <0x000>;
	battery,curr_slope = <0x8080>;
	battery,topoff_soc = <7 343>;
	battery,temp_std = <25>;
	battery,temp_offset = <0 11 1 0 8 (-1)>;
	battery,temp_cal = <0 6 1 11 (-1) 0 6 1 9 1>;
	battery,ext_temp_cal = <0 2 1 2 1 0 2 3 2 3>;
	battery,tem_poff = <3400 100>;
        battery,thermal_table = <0x3EEF 0x3957 0x3234 0x2C25 0x2654 0x2089 0x1B71 0x1574 0x1068 0x0B3C
				0x0640 0x0181 0xF4FA 0xF09D 0xEC1E 0xE82D 0xE3B3 0xDFE0 0xDC28 0xD88E
				0xD580 0xD22A 0xCF03 0xCC0B 0xC944 0xC68E 0xC405 0xC169 0xBF0F 0xBCFD
				0xBABE 0xB889 0xB692 0xB4AB 0xB2E5 0xB127 0xAF8E 0xAE0F 0xAC8A 0xAB1E
				0xA9E9 0xA888 0xA742 0xA620 0xA4A5 0xA39C 0xA2A5 0xA1BE 0xA0CF 0x9FF9
				0x9F2C 0x9E67 0x9DA0 0x9CEC 0x9C43 0x9BA1 0x9AFF 0x9A6F 0x99D9 0x9950
				0x98D0 0x9857 0x97E8 0x9776 0x96FD 0x9695 0x9632 0x95D5 0x9579 0x9522
				0x94CF 0x9480 0x9434 0x93EB 0x93A4 0x9361 0x9322 0x92E7 0x92AF 0x9278
				0x9242 0x920E 0x91DD 0x91AF 0x9181 0x9156 0x912E 0x9107 0x90E2 0x90BF
				0x909C 0x907A 0x905A 0x903B 0x901E 0x9003 0x8FE7 0x8FCE 0x8FB4 0x8F9D
				0x8F85>;  //NTC value(DEC) table -20~80
};
