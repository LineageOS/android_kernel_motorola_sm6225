/*
 * Copyright (C) 2021 Motorola Inc.
 *
 * This program is free software; you can redistribute it and/or modify
 * it under the terms of the GNU General Public License version 2 as
 * published by the Free Software Foundation.
 *
 * This program is distributed in the hope that it will be useful,
 * but WITHOUT ANY WARRANTY; without even the implied warranty of
 * MERCHANTABILITY or FITNESS FOR A PARTICULAR PURPOSE.
 * See http://www.gnu.org/licenses/gpl-2.0.html for more details.
 */
sm5602-nd50-atl-5000mah {
	serialnum = "SB18D24973";
	battery,param_version = <2>;
	battery,max_voltage_uv = <4450000>;
	battery,battery_type = <4450 0x0 0x2633>;
	battery,battery_table0 = <0x1400 0x1C8A 0x1D03 0x1D72 0x1D7E 0x1D87 0x1D91 0x1DAD 0x1DE0
                                  0x1E0C 0x1E3B 0x1E70 0x1EBE 0x1F18 0x1F48 0x1F98 0x1FF1 0x20BB
                                  0x216C 0x21E8 0x2241 0x22EB 0x2337 0x2733>;
	battery,battery_table1 = <0x0 0x85 0x191 0x323 0x3A9 0x4B5 0x6CD 0xAFE 0xF2E 0x146A 0x19A7
                                  0x2181 0x2BFA 0x33D4 0x3672 0x3911 0x3E4D 0x48C6 0x50A0 0x55DC
                                  0x5987 0x60DB 0x6400 0x64E6>;
	battery,battery_table2 = <0x2033 0x181B 0x1516 0x1213 0x1011 0x0F0F 0x0E0F 0x0E0E>;
	battery,alpha = <0x00CC>;
	battery,beta = <0x0025>;
	battery,rs = <0x805F>;
	battery,rs_value = <0x0050 0x010A 0x3800 0x0048>;
	battery,vit_period = <0x325A>;
	battery,volt_cal = <0x8000>;
	battery,mix_value = <0x0003>;
	battery,curr_offset = <0x000>;
	battery,curr_slope = <0x8080>;
	battery,topoff_soc = <7 400>;
	battery,temp_std = <25>;
	battery,temp_offset = <0 11 1 0 8 (-1)>;
	battery,temp_cal = <0 6 1 11 (-1) 0 6 1 9 1>;
	battery,ext_temp_cal = <0 2 1 2 1 0 2 3 2 3>;
	battery,tem_poff = <3450 100>;
	battery,thermal_table = <0x435B 0x3E57 0x3963 0x3486 0x2FC5 0x2B1B 0x2688 0x2200 0x1DA3 0x1932
				0x1534 0x1148 0x0D46 0x096E 0x05A0 0x01F4 0xF62D 0xF2BC 0xEF68 0xEC08
				0xE8E0 0xE5D2 0xE2DC 0xDFFC 0xDD33 0xDA83 0xD7E5 0xD55E 0xD2EF 0xD092
				0xCE4A 0xCC12 0xC9EF 0xC7E3 0xC5E4 0xC3F8 0xC21D 0xC051 0xBE97 0xBCE9
				0xBB4D 0xB9C2 0xB840 0xB6CF 0xB569 0xB40F 0xB2C2 0xB17F 0xB049 0xAF1E
				0xADFD 0xACE4 0xABD7 0xAAD5 0xA9DD 0xA8EB 0xA805 0xA71E 0xA648 0xA577
				0xA4B0 0xA3ED 0xA32F 0xA27D 0xA1CE 0xA124 0xA082 0x9FE7 0x9F50 0x9EBC
			        0x9E2B 0x9DA3 0x9D20 0x9CA1 0x9C27 0x9BAF 0x9B3B 0x9ACC 0x9A62 0x99FA
				0x9996 0x9938 0x98DE 0x9885 0x982E 0x97DA 0x978A 0x973D 0x96F2 0x96AA
				0x9665 0x9621 0x95DF 0x959F 0x9561 0x9525 0x94EB 0x94B3 0x947C 0x9447
				0x9414>;  //NTC value(DEC) table -20~80
};
