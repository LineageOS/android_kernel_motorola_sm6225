/* Copyright (c) 2019, The Linux Foundation. All rights reserved.
 *
 * This program is free software; you can redistribute it and/or modify
 * it under the terms of the GNU General Public License version 2 and
 * only version 2 as published by the Free Software Foundation.
 *
 * This program is distributed in the hope that it will be useful,
 * but WITHOUT ANY WARRANTY; without even the implied warranty of
 * MERCHANTABILITY or FITNESS FOR A PARTICULAR PURPOSE.  See the
 * GNU General Public License for more details.
 */

&soc{
	mtp_batterydata: qcom,battery-data {
              qcom,batt-id-range-pct = <15>;
              df-serialnum = "SB18C85291";
              #include "qg-batterydata-jk50-atl-4850mah.dtsi"
              #include "qg-batterydata-jk50-scud-4850mah.dtsi"
              #include "qg-batterydata-jk50-atl-flex-4850mah.dtsi"
              #include "qg-batterydata-jk50-atl-unicoba-4850mah.dtsi"
              #include "qg-batterydata-jk50-swd-4850mah.dtsi"
	};
};

&pmi632_qg {
        qcom,qg-iterm-ma = <350>;
};

&pmi632_charger {
        qcom,iterm-ma = <100>;
        qcom,fcc-max-ua = <2400000>;
        qcom,fv-max-uv = <4400000>;
        qcom,usb-icl-ua = <2000000>;
        qcom,thermal-mitigation = <2000>,
                                   <1800>,
                                   <1600>,
                                   <1300>,
                                   <1100>,
                                   <900>,
                                   <600>,
                                   <400>;
        qcom,mmi-temp-zones = <0 4200 1000 0>,
                                <10 4200 1000 1000>,
                                <15 0 1000 1000>,
                                <45 0 2400 2400>,
                                <60 4200 2400 0>;
        qcom,hvdcp-disable;
        qcom,support-2a-dcp;
};
